## CMakeLists.txt
```
cmake_minimum_required(VERSION 3.24)

# Use configuration overlay to disable default portable ops to enable selective operator build
set(CONF_FILE "${CMAKE_CURRENT_SOURCE_DIR}/prj.conf;${CMAKE_CURRENT_SOURCE_DIR}/prj_selective.conf")

find_package(Zephyr REQUIRED HINTS $ENV{ZEPHYR_BASE})
project(executorch_hello_world)

set(CMAKE_CXX_FLAGS "${CMAKE_CXX_FLAGS} -Wall -Wno-switch -Wno-float-conversion -Wno-double-promotion -ffunction-sections -fdata-sections")

# Always use selective build since embedded devices are resource constrained
    
# Include ExecuTorch selective build utilities
# Use EXECUTORCH_DIR if available, otherwise use Zephyr's module discovery
if(NOT DEFINED EXECUTORCH_DIR)
    message(STATUS "ZEPHYR_EXECUTORCH_MODULE_DIR set to : ${ZEPHYR_EXECUTORCH_MODULE_DIR}")
    if(DEFINED ZEPHYR_EXECUTORCH_MODULE_DIR)
        set(EXECUTORCH_DIR ${ZEPHYR_EXECUTORCH_MODULE_DIR})
        message(STATUS "Using Zephyr module discovery: EXECUTORCH_DIR=${EXECUTORCH_DIR}")
    else()
        message(FATAL_ERROR "ExecutorTorch module not found. Ensure it's properly configured in your Zephyr workspace.")
    endif()
else()
    message(STATUS "Using predefined EXECUTORCH_DIR=${EXECUTORCH_DIR}")
endif()
    
# Set EXECUTORCH_ROOT for the Codegen.cmake file 
set(EXECUTORCH_ROOT ${EXECUTORCH_DIR})
    
include(${EXECUTORCH_DIR}/tools/cmake/Utils.cmake)
include(${EXECUTORCH_DIR}/tools/cmake/Codegen.cmake)
    
# Generate selective operators library
gen_selected_ops(
    LIB_NAME "hello_world_ops_lib" 
    INCLUDE_ALL_OPS "ON"
)
    #ROOT_OPS "aten::_softmax.out,aten::add.out,aten::addmm.out,aten::any.out,aten::bmm.out,aten::clone.out,aten::convolution.out,aten::eq.Scalar_out,aten::expand_copy.out,aten::full_like.out,aten::gelu.out,aten::logical_not.out,aten::mm.out,aten::mul.Scalar_out,aten::native_layer_norm.out,aten::permute_copy.out,aten::where.self_out"
    #OPS_FROM_MODEL "/home/zephyruser/zephyr/samples/modules/executorch/arm/hello_world/whisper/encoder.pte"
	#OPS_SCHEMA_YAML "${OPS_DEF_FILE}"
	#INCLUDE_ALL_OPS "ON"
#	OPS_FROM_MODEL "/home/zephyruser/zephyr/samples/modules/executorch/arm/hello_world/add.pte"
#	DTYPE_SELECTIVE_BUILD "ON"
# Generate bindings for the selected kernels
generate_bindings_for_kernels(
    LIB_NAME "hello_world_ops_lib" 
    FUNCTIONS_YAML "${EXECUTORCH_ROOT}/kernels/portable/functions.yaml"
)
#	DTYPE_SELECTIVE_BUILD "OFF"
   
# Create the actual library target with portable kernels
# portable_kernels provides the actual kernel implementations (add_out, etc.)
gen_operators_lib(
    LIB_NAME "hello_world_ops_lib" 
    KERNEL_LIBS portable_kernels
    DEPS executorch_core
)
#	DTYPE_SELECTIVE_BUILD "OFF"
    
# Use our custom selective operators library
set(EXECUTORCH_OPS_LIB hello_world_ops_lib)
message(STATUS "Using selective operators library: ${EXECUTORCH_OPS_LIB}")

set(app_sources
	src/arm_executor_runner.cpp
        ${EXECUTORCH_DIR}/examples/arm/executor_runner/arm_memory_allocator.cpp
        ${EXECUTORCH_DIR}/examples/arm/executor_runner/arm_perf_monitor.cpp
)
	#${EXECUTORCH_DIR}/runtime/platform/default/arm_zephyr.cpp
target_sources(app PRIVATE ${app_sources})

zephyr_linker_sources(SECTIONS linker.ld)
if (CONFIG_CODE_DATA_RELOCATION)
    file(GLOB_RECURSE ET_OP_SRC_FILES ${EXECUTORCH_ROOT}/op_*.cpp )
    zephyr_code_relocate(FILES ${ET_OP_SRC_FILES} LOCATION DDR4S2_TEXT_RODATA NOCOPY)
endif()

# Link with ExecuTorch and our operators library
target_link_libraries(app PRIVATE 
    libexecutorch
    ${EXECUTORCH_OPS_LIB}
)

# Add include directory for generated headers
target_include_directories(app PRIVATE src) 
get_target_property(OUT app LINK_LIBRARIES)
message(STATUS ${OUT})
```

## prj.conf
```kconfig
# Enable ExecuTorch
CONFIG_EXECUTORCH=y
CONFIG_EXECUTORCH_BACKEND_ARM=y

# C++
CONFIG_CPP=y
CONFIG_STD_CPP17=y
CONFIG_NEWLIB_LIBC=y

# Config - increased for ExecuTorch memory requirements
CONFIG_MAIN_STACK_SIZE=8192
CONFIG_HEAP_MEM_POOL_SIZE=32768
CONFIG_REQUIRES_FLOAT_PRINTF=y

# Logging
CONFIG_LOG=y
CONFIG_LOG_PRINTK=y
CONFIG_LOG_BACKEND_UART=y
CONFIG_CBPRINTF_FP_SUPPORT=y

# Allow usage of non itcm memory fo rlibexecutorch
CONFIG_CODE_DATA_RELOCATION=y
```

## prj_selective.conf
```kconfig
# Configuration for selective operator builds
# Disable default portable operators registry when using selective operators
# (portable kernels will be automatically built to support selective builds)
CONFIG_EXECUTORCH_BUILD_PORTABLE_OPS=n 
```

## src/main.cpp
```c
/*
 * Copyright (c) 2025 Petri Oksanen
 *
 * SPDX-License-Identifier: Apache-2.0
 */

#include <zephyr/kernel.h>
#include <zephyr/logging/log.h>

#include "program_loader.h"

LOG_MODULE_REGISTER(main, LOG_LEVEL_INF);

int main(void) {
	LOG_INF("ExecuTorch ARM Hello World Sample");
	
	// Get program loader instance and initialize it
	ProgramLoader& loader = ProgramLoader::getInstance();
	loader.initialize();
	
	// Load the embedded model
	auto error = loader.loadProgram();
	if (error != executorch::runtime::Error::Ok) {
		LOG_ERR("Failed to load program: %d", (int)error);
		return -1;
	}
	
	LOG_INF("Program loaded successfully");
	
	// Test data: simple addition
	float input1[] = {2.0f};
	float input2[] = {3.0f};
	float output[1];
	
	// Run inference
	error = loader.runInference(input1, input2, 1, output, 1);
	if (error != executorch::runtime::Error::Ok) {
		LOG_ERR("Inference failed: %d", (int)error);
		return -1;
	}
	
	LOG_INF("Inference result: %.2f + %.2f = %.2f", 
			input1[0], input2[0], output[0]);
	
	// Expected result should be 5.0
	if (output[0] == 5.0f) {
		LOG_INF("✓ Test PASSED: Addition worked correctly!");
	} else {
		LOG_ERR("✗ Test FAILED: Expected 5.0, got %.2f", output[0]);
		return -1;
	}
	
	return 0;
} 
```

## src/arm_memory_allocator.hpp
```c
#ifndef _ARM_MEMORY_ALLOCATOR_HPP
#define _ARM_MEMORY_ALLOCATOR_HPP

#include <executorch/runtime/core/memory_allocator.h>

using executorch::runtime::MemoryAllocator;

// Setup our own allocator that can show some extra stuff like used and free
// memory info
class ArmMemoryAllocator : public MemoryAllocator {
 public:
  ArmMemoryAllocator(uint32_t size, uint8_t* base_address)
      : MemoryAllocator(size, base_address), used_(0), peak_used_(0) {}

  void* allocate(size_t size, size_t alignment = kDefaultAlignment) override {
    void* ret = MemoryAllocator::allocate(size, alignment);
    if (ret != nullptr) {
      // Align with the same code as in MemoryAllocator::allocate() to keep
      // used_ "in sync" As alignment is expected to be power of 2 (checked by
      // MemoryAllocator::allocate()) we can check it the lower bits
      // (same as alignment - 1) is zero or not.
      if ((size & (alignment - 1)) == 0) {
        // Already aligned.
        used_ += size;
      } else {
        used_ = (used_ | (alignment - 1)) + 1 + size;
      }
      if (used_ > peak_used_)
        peak_used_ = used_;
    }
    return ret;
  }

  // Returns the used size of the allocator's memory buffer.
  size_t used_size() const {
    return used_;
  }

  // Returns the peak memory usage of the allocator's memory buffer
  // Peak usage is useful when doing multiple allocations & resets
  size_t peak_used() const {
    return peak_used_;
  }

  // Returns the free size of the allocator's memory buffer.
  size_t free_size() const {
    return MemoryAllocator::size() - used_;
  }

  void reset() {
    MemoryAllocator::reset();
    used_ = 0;
  }

 private:
  size_t used_;
  size_t peak_used_;
};

#endif  // _ARM_MEMORY_ALLOCATOR_HPP
```

## src/arm_zephyr_pal.hpp
```c
#ifndef _ARM_ZEPHYR_PAL_HPP
#define _ARM_ZEPHYR_PAL_HPP

#include <zephyr/kernel.h>
#include <zephyr/sys/printk.h>

void et_pal_init(void) {
  // Enable ARM PMU Clock
//  ARM_PMU_Enable();
//  DCB->DEMCR |= DCB_DEMCR_TRCENA_Msk; // Trace enable
//  ARM_PMU_CYCCNT_Reset();
//  ARM_PMU_CNTR_Enable(PMU_CNTENSET_CCNTR_ENABLE_Msk);
}

/**
 * Implementation of the et_pal_<funcs>()
 *
 * This functions are hardware adaption type of functions for things like
 * time/logging/memory allocation that could call your RTOS or need to to
 * be implemnted in some way.
 */

ET_NORETURN void et_pal_abort(void) {
#if !defined(SEMIHOSTING)
  __builtin_trap();
#else
  _exit(-1);
#endif
}

et_timestamp_t et_pal_current_ticks(void) {
//  return ARM_PMU_Get_CCNTR();
	return k_uptime_ticks();
}

et_tick_ratio_t et_pal_ticks_to_ns_multiplier(void) {
  // Since we don't know the CPU freq for your target and justs cycles in the
  // FVP for et_pal_current_ticks() we return a conversion ratio of 1
  return {1, 1};
}

/**
 * Emit a log message via platform output (serial port, console, etc).
 */
void et_pal_emit_log_message(
    ET_UNUSED et_timestamp_t timestamp,
    et_pal_log_level_t level,
    const char* filename,
    ET_UNUSED const char* function,
    size_t line,
    const char* message,
    ET_UNUSED size_t length) {
  fprintf(
      stderr,
      "%c [executorch:%s:%zu %s()] %s\n",
      level,
      filename,
      line,
      function,
      message);
}

/**
 * Dynamic memory allocators intended to be used by temp_allocator
 * to implement malloc()/free() type of allocations.
 * Currenyly not used.
 */

void* et_pal_allocate(ET_UNUSED size_t size) {
//  return nullptr;
  return k_malloc(size);
}

void et_pal_free(ET_UNUSED void* ptr) {
  k_free(ptr);
} 

#endif // _ARM_ZEPHYR_PAL_HPP
```

## src/et_memory_allocator.hpp
```c
#ifndef _ET_MEMORY_ALLOCATOR_HPP
#define _ET_MEMORY_ALLOCATOR_HPP

#include <executorch/runtime/core/memory_allocator.h>

using executorch::runtime::MemoryAllocator;

class ArmMemoryAllocator : public MemoryAllocator {
public:
    ArmMemoryAllocator(uint32_t size, uint8_t* base_address) : MemoryAllocator(size, base_address), used_(0) {}

    void* allocate(size_t size, size_t alignment = kDefaultAlignment) override {
        void* ret = MemoryAllocator::allocate(size, alignment);
        if (ret != nullptr) {
            if ((size & (alignment - 1)) == 0) {
                used_ += size;
            } else {
                used_ = (used_ & ~(alignment - 1)) + alignment + size;
            }
        }
        return ret;
    }

    size_t used_size() const { return used_; }
    size_t free_size() const { return MemoryAllocator::size() - used_; }

private:
    size_t used_;
};

#endif  // _ET_MEMORY_ALLOCATOR_HPP
```

## src/model_pte.h
```c
__ALIGN(16) const char model_pte[] = {
0x1c, 0x00, 0x00, 0x00, 0x45, 0x54, 0x31, 0x32, 0x00, 0x00, 0x00, 0x00, 0x10, 0x00, 0x18, 0x00, 0x00, 0x00, 0x04, 0x00, 0x08, 0x00, 0x0c, 0x00, 0x10, 0x00, 0x14, 0x00, 0x10, 0x00, 0x00, 0x00, 
0x44, 0x00, 0x00, 0x00, 0x3c, 0x00, 0x00, 0x00, 0x34, 0x00, 0x00, 0x00, 0x20, 0x00, 0x00, 0x00, 0x04, 0x00, 0x00, 0x00, 0x0c, 0xff, 0xff, 0xff, 0x04, 0x00, 0x00, 0x00, 0x01, 0x00, 0x00, 0x00, 
0x00, 0x00, 0x00, 0x00, 0x00, 0x00, 0x00, 0x00, 0x00, 0x00, 0x00, 0x00, 0x01, 0x00, 0x00, 0x00, 0x08, 0x00, 0x00, 0x00, 0x04, 0x00, 0x04, 0x00, 0x04, 0x00, 0x00, 0x00, 0x00, 0x00, 0x00, 0x00, 
0x00, 0x00, 0x00, 0x00, 0x01, 0x00, 0x00, 0x00, 0x1c, 0x00, 0x00, 0x00, 0x00, 0x00, 0x16, 0x00, 0x28, 0x00, 0x04, 0x00, 0x08, 0x00, 0x0c, 0x00, 0x10, 0x00, 0x14, 0x00, 0x18, 0x00, 0x1c, 0x00, 
0x20, 0x00, 0x24, 0x00, 0x16, 0x00, 0x00, 0x00, 0x9c, 0x03, 0x00, 0x00, 0x10, 0x02, 0x00, 0x00, 0xdc, 0x00, 0x00, 0x00, 0xcc, 0x00, 0x00, 0x00, 0xc0, 0x00, 0x00, 0x00, 0x54, 0x00, 0x00, 0x00, 
0x24, 0x00, 0x00, 0x00, 0x1c, 0x00, 0x00, 0x00, 0x04, 0x00, 0x00, 0x00, 0x02, 0x00, 0x00, 0x00, 0x00, 0x00, 0x00, 0x00, 0x00, 0x00, 0x00, 0x00, 0x30, 0x00, 0x00, 0x00, 0x00, 0x00, 0x00, 0x00, 
0x00, 0x00, 0x00, 0x00, 0x01, 0x00, 0x00, 0x00, 0x04, 0x00, 0x00, 0x00, 0x38, 0xfe, 0xff, 0xff, 0x10, 0x00, 0x00, 0x00, 0x04, 0x00, 0x00, 0x00, 0x03, 0x00, 0x00, 0x00, 0x6f, 0x75, 0x74, 0x00, 
0x09, 0x00, 0x00, 0x00, 0x61, 0x74, 0x65, 0x6e, 0x3a, 0x3a, 0x61, 0x64, 0x64, 0x00, 0x00, 0x00, 0x01, 0x00, 0x00, 0x00, 0x10, 0x00, 0x00, 0x00, 0x00, 0x00, 0x0a, 0x00, 0x10, 0x00, 0x04, 0x00, 
0x08, 0x00, 0x0c, 0x00, 0x0a, 0x00, 0x00, 0x00, 0x4c, 0x00, 0x00, 0x00, 0x44, 0x00, 0x00, 0x00, 0x04, 0x00, 0x00, 0x00, 0x01, 0x00, 0x00, 0x00, 0x04, 0x00, 0x00, 0x00, 0x24, 0xff, 0xff, 0xff, 
0x00, 0x00, 0x00, 0x01, 0x0c, 0x00, 0x00, 0x00, 0x08, 0x00, 0x08, 0x00, 0x00, 0x00, 0x04, 0x00, 0x08, 0x00, 0x00, 0x00, 0x04, 0x00, 0x00, 0x00, 0x05, 0x00, 0x00, 0x00, 0x00, 0x00, 0x00, 0x00, 
0x01, 0x00, 0x00, 0x00, 0x03, 0x00, 0x00, 0x00, 0x02, 0x00, 0x00, 0x00, 0x02, 0x00, 0x00, 0x00, 0x00, 0x00, 0x00, 0x00, 0x00, 0x00, 0x00, 0x00, 0x01, 0x00, 0x00, 0x00, 0x02, 0x00, 0x00, 0x00, 
0x02, 0x00, 0x00, 0x00, 0x00, 0x00, 0x00, 0x00, 0x01, 0x00, 0x00, 0x00, 0x04, 0x00, 0x00, 0x00, 0xd4, 0x00, 0x00, 0x00, 0x8c, 0x00, 0x00, 0x00, 0x2c, 0x00, 0x00, 0x00, 0x04, 0x00, 0x00, 0x00, 
0x44, 0xff, 0xff, 0xff, 0x00, 0x00, 0x00, 0x02, 0x0c, 0x00, 0x00, 0x00, 0x00, 0x00, 0x06, 0x00, 0x10, 0x00, 0x04, 0x00, 0x06, 0x00, 0x00, 0x00, 0x01, 0x00, 0x00, 0x00, 0x00, 0x00, 0x00, 0x00, 
0x00, 0x00, 0x00, 0x00, 0x68, 0xff, 0xff, 0xff, 0x00, 0x00, 0x00, 0x05, 0x18, 0x00, 0x00, 0x00, 0x00, 0x00, 0x12, 0x00, 0x16, 0x00, 0x07, 0x00, 0x00, 0x00, 0x08, 0x00, 0x0c, 0x00, 0x00, 0x00, 
0x00, 0x00, 0x10, 0x00, 0x12, 0x00, 0x00, 0x00, 0x00, 0x00, 0x00, 0x06, 0x24, 0x00, 0x00, 0x00, 0x18, 0x00, 0x00, 0x00, 0x0c, 0x00, 0x00, 0x00, 0x00, 0x00, 0x06, 0x00, 0x08, 0x00, 0x04, 0x00, 
0x06, 0x00, 0x00, 0x00, 0x01, 0x00, 0x00, 0x00, 0x01, 0x00, 0x00, 0x00, 0x00, 0x00, 0x00, 0x00, 0x01, 0x00, 0x00, 0x00, 0x01, 0x00, 0x00, 0x00, 0x08, 0x00, 0x0c, 0x00, 0x07, 0x00, 0x08, 0x00, 
0x08, 0x00, 0x00, 0x00, 0x00, 0x00, 0x00, 0x05, 0x04, 0x00, 0x00, 0x00, 0xba, 0xff, 0xff, 0xff, 0x00, 0x00, 0x00, 0x06, 0x20, 0x00, 0x00, 0x00, 0x14, 0x00, 0x00, 0x00, 0x04, 0x00, 0x00, 0x00, 
0x8c, 0xff, 0xff, 0xff, 0x01, 0x00, 0x00, 0x00, 0x10, 0x00, 0x00, 0x00, 0x01, 0x00, 0x00, 0x00, 0x00, 0x00, 0x00, 0x00, 0x01, 0x00, 0x00, 0x00, 0x01, 0x00, 0x00, 0x00, 0x08, 0x00, 0x0e, 0x00, 
0x07, 0x00, 0x08, 0x00, 0x08, 0x00, 0x00, 0x00, 0x00, 0x00, 0x00, 0x05, 0x18, 0x00, 0x00, 0x00, 0x00, 0x00, 0x12, 0x00, 0x14, 0x00, 0x07, 0x00, 0x00, 0x00, 0x08, 0x00, 0x0c, 0x00, 0x00, 0x00, 
0x00, 0x00, 0x10, 0x00, 0x12, 0x00, 0x00, 0x00, 0x00, 0x00, 0x00, 0x06, 0x20, 0x00, 0x00, 0x00, 0x14, 0x00, 0x00, 0x00, 0x04, 0x00, 0x00, 0x00, 0xe4, 0xff, 0xff, 0xff, 0x01, 0x00, 0x00, 0x00, 
0x20, 0x00, 0x00, 0x00, 0x01, 0x00, 0x00, 0x00, 0x00, 0x00, 0x00, 0x00, 0x01, 0x00, 0x00, 0x00, 0x01, 0x00, 0x00, 0x00, 0x08, 0x00, 0x0c, 0x00, 0x04, 0x00, 0x08, 0x00, 0x08, 0x00, 0x00, 0x00, 
0x48, 0x00, 0x00, 0x00, 0x04, 0x00, 0x00, 0x00, 0x39, 0x00, 0x00, 0x00, 0x5b, 0x31, 0x2c, 0x20, 0x7b, 0x22, 0x74, 0x79, 0x70, 0x65, 0x22, 0x3a, 0x20, 0x6e, 0x75, 0x6c, 0x6c, 0x2c, 0x20, 0x22, 
0x63, 0x6f, 0x6e, 0x74, 0x65, 0x78, 0x74, 0x22, 0x3a, 0x20, 0x6e, 0x75, 0x6c, 0x6c, 0x2c, 0x20, 0x22, 0x63, 0x68, 0x69, 0x6c, 0x64, 0x72, 0x65, 0x6e, 0x5f, 0x73, 0x70, 0x65, 0x63, 0x22, 0x3a, 
0x20, 0x5b, 0x5d, 0x7d, 0x5d, 0x00, 0x00, 0x00, 0x34, 0x01, 0x00, 0x00, 0x5b, 0x31, 0x2c, 0x20, 0x7b, 0x22, 0x74, 0x79, 0x70, 0x65, 0x22, 0x3a, 0x20, 0x22, 0x62, 0x75, 0x69, 0x6c, 0x74, 0x69, 
0x6e, 0x73, 0x2e, 0x74, 0x75, 0x70, 0x6c, 0x65, 0x22, 0x2c, 0x20, 0x22, 0x63, 0x6f, 0x6e, 0x74, 0x65, 0x78, 0x74, 0x22, 0x3a, 0x20, 0x22, 0x6e, 0x75, 0x6c, 0x6c, 0x22, 0x2c, 0x20, 0x22, 0x63, 
0x68, 0x69, 0x6c, 0x64, 0x72, 0x65, 0x6e, 0x5f, 0x73, 0x70, 0x65, 0x63, 0x22, 0x3a, 0x20, 0x5b, 0x7b, 0x22, 0x74, 0x79, 0x70, 0x65, 0x22, 0x3a, 0x20, 0x22, 0x62, 0x75, 0x69, 0x6c, 0x74, 0x69, 
0x6e, 0x73, 0x2e, 0x74, 0x75, 0x70, 0x6c, 0x65, 0x22, 0x2c, 0x20, 0x22, 0x63, 0x6f, 0x6e, 0x74, 0x65, 0x78, 0x74, 0x22, 0x3a, 0x20, 0x22, 0x6e, 0x75, 0x6c, 0x6c, 0x22, 0x2c, 0x20, 0x22, 0x63, 
0x68, 0x69, 0x6c, 0x64, 0x72, 0x65, 0x6e, 0x5f, 0x73, 0x70, 0x65, 0x63, 0x22, 0x3a, 0x20, 0x5b, 0x7b, 0x22, 0x74, 0x79, 0x70, 0x65, 0x22, 0x3a, 0x20, 0x6e, 0x75, 0x6c, 0x6c, 0x2c, 0x20, 0x22, 
0x63, 0x6f, 0x6e, 0x74, 0x65, 0x78, 0x74, 0x22, 0x3a, 0x20, 0x6e, 0x75, 0x6c, 0x6c, 0x2c, 0x20, 0x22, 0x63, 0x68, 0x69, 0x6c, 0x64, 0x72, 0x65, 0x6e, 0x5f, 0x73, 0x70, 0x65, 0x63, 0x22, 0x3a, 
0x20, 0x5b, 0x5d, 0x7d, 0x2c, 0x20, 0x7b, 0x22, 0x74, 0x79, 0x70, 0x65, 0x22, 0x3a, 0x20, 0x6e, 0x75, 0x6c, 0x6c, 0x2c, 0x20, 0x22, 0x63, 0x6f, 0x6e, 0x74, 0x65, 0x78, 0x74, 0x22, 0x3a, 0x20, 
0x6e, 0x75, 0x6c, 0x6c, 0x2c, 0x20, 0x22, 0x63, 0x68, 0x69, 0x6c, 0x64, 0x72, 0x65, 0x6e, 0x5f, 0x73, 0x70, 0x65, 0x63, 0x22, 0x3a, 0x20, 0x5b, 0x5d, 0x7d, 0x5d, 0x7d, 0x2c, 0x20, 0x7b, 0x22, 
0x74, 0x79, 0x70, 0x65, 0x22, 0x3a, 0x20, 0x22, 0x62, 0x75, 0x69, 0x6c, 0x74, 0x69, 0x6e, 0x73, 0x2e, 0x64, 0x69, 0x63, 0x74, 0x22, 0x2c, 0x20, 0x22, 0x63, 0x6f, 0x6e, 0x74, 0x65, 0x78, 0x74, 
0x22, 0x3a, 0x20, 0x22, 0x5b, 0x5d, 0x22, 0x2c, 0x20, 0x22, 0x63, 0x68, 0x69, 0x6c, 0x64, 0x72, 0x65, 0x6e, 0x5f, 0x73, 0x70, 0x65, 0x63, 0x22, 0x3a, 0x20, 0x5b, 0x5d, 0x7d, 0x5d, 0x7d, 0x5d, 
0x00, 0x00, 0x00, 0x00, 0x07, 0x00, 0x00, 0x00, 0x66, 0x6f, 0x72, 0x77, 0x61, 0x72, 0x64, 0x00, };
```

## src/program_loader.cpp
```c
#include "program_loader.h"

#include <zephyr/kernel.h>
#include <zephyr/logging/log.h>

#include <memory>
#include <cstring>

#include "model_pte.h"

LOG_MODULE_REGISTER(program_loader, LOG_LEVEL_INF);

// Memory pool configuration - reduced for embedded targets
#define ET_ARM_BAREMETAL_METHOD_ALLOCATOR_POOL_SIZE (16 * 1024)  // 16KB instead of 64KB
#define ET_ARM_BAREMETAL_TEMP_ALLOCATOR_POOL_SIZE (2 * 1024)     // 2KB instead of 4KB

static unsigned char method_allocation_pool[ET_ARM_BAREMETAL_METHOD_ALLOCATOR_POOL_SIZE];
static unsigned char temp_allocation_pool[ET_ARM_BAREMETAL_TEMP_ALLOCATOR_POOL_SIZE];

ProgramLoader::ProgramLoader() 
    : initialized_(false),
      method_(nullptr) {
    // Constructor is now minimal - no complex initialization
}

void ProgramLoader::initialize() {
    if (initialized_) {
        return; // Already initialized
    }
    
    LOG_INF("Initializing ProgramLoader...");
    
    // Initialize ExecuTorch runtime
    executorch::runtime::runtime_init();
    
    // Create memory allocators
    method_allocator_ = std::make_unique<ArmMemoryAllocator>(
        ET_ARM_BAREMETAL_METHOD_ALLOCATOR_POOL_SIZE, 
        method_allocation_pool
    );
    
    temp_allocator_ = std::make_unique<ArmMemoryAllocator>(
        ET_ARM_BAREMETAL_TEMP_ALLOCATOR_POOL_SIZE, 
        temp_allocation_pool
    );
    
    initialized_ = true;
    LOG_INF("ProgramLoader initialized successfully");
}

Error ProgramLoader::loadProgram() {
    // Ensure we're initialized
    if (!initialized_) {
        LOG_ERR("ProgramLoader not initialized - call initialize() first");
        return Error::InvalidState;
    }
    
    // Calculate model size from the array
    size_t model_size = sizeof(model_pte);
    
    LOG_INF("Loading embedded program, size: %zu bytes", model_size);
    
    // Create data loader for embedded model
    auto loader = std::make_unique<BufferDataLoader>(model_pte, model_size);
    
    // Load program
    auto program_result = Program::load(loader.get());
    if (!program_result.ok()) {
        LOG_ERR("Failed to load program: %d", (int)program_result.error());
        return program_result.error();
    }
    
    program_ = std::make_unique<Program>(std::move(program_result.get()));
    LOG_INF("Program loaded successfully");
    
    // Get method metadata to determine memory planning requirements
    auto method_meta_result = program_->method_meta("forward");
    if (!method_meta_result.ok()) {
        LOG_ERR("Failed to get method metadata: %d", (int)method_meta_result.error());
        return method_meta_result.error();
    }
    
    MethodMeta method_meta = method_meta_result.get();
    
    // Allocate memory-planned buffers
    size_t num_memory_planned_buffers = method_meta.num_memory_planned_buffers();
    LOG_INF("Method requires %zu memory-planned buffers", num_memory_planned_buffers);
    
    planned_buffers_.clear();
    planned_spans_.clear();
    
    for (size_t id = 0; id < num_memory_planned_buffers; ++id) {
        auto buffer_size_result = method_meta.memory_planned_buffer_size(id);
        if (!buffer_size_result.ok()) {
            LOG_ERR("Failed to get buffer size for buffer %zu: %d", id, (int)buffer_size_result.error());
            return buffer_size_result.error();
        }
        
        size_t buffer_size = static_cast<size_t>(buffer_size_result.get());
        LOG_INF("Allocating planned buffer %zu, size %zu bytes", id, buffer_size);
        
        uint8_t* buffer = reinterpret_cast<uint8_t*>(method_allocator_->allocate(buffer_size));
        if (!buffer) {
            LOG_ERR("Failed to allocate memory-planned buffer %zu of size %zu", id, buffer_size);
            return Error::MemoryAllocationFailed;
        }
        
        planned_buffers_.push_back(buffer);
        planned_spans_.push_back({planned_buffers_.back(), buffer_size});
    }
    
    // Create hierarchical allocator for planned memory
    planned_memory_ = std::make_unique<HierarchicalAllocator>(
        HierarchicalAllocator({planned_spans_.data(), planned_spans_.size()})
    );
    
    // Update memory manager with planned memory
    memory_manager_ = std::make_unique<MemoryManager>(
        method_allocator_.get(),         // method_allocator
        planned_memory_.get(),           // planned_memory 
        temp_allocator_.get()           // temp_allocator
    );
    
    // Load method with updated memory manager
    auto method_result = program_->load_method("forward", memory_manager_.get());
    if (!method_result.ok()) {
        LOG_ERR("Failed to load method 'forward': %d", (int)method_result.error());
        return method_result.error();
    }
    
    method_ = std::make_unique<Result<Method>>(std::move(method_result));
    LOG_INF("Method 'forward' loaded successfully");
    
    return Error::Ok;
}

Error ProgramLoader::createInputTensor(const float* data, size_t size, size_t input_index) {
    if (!isLoaded()) {
        LOG_ERR("Program not loaded");
        return Error::InvalidState;
    }
    
    Method& method = method_->get();
    
    // Get input tensor metadata
    auto tensor_meta_result = method.method_meta().input_tensor_meta(input_index);
    if (!tensor_meta_result.ok()) {
        LOG_ERR("Failed to get input tensor meta for index %zu: %d", 
                input_index, (int)tensor_meta_result.error());
        return tensor_meta_result.error();
    }
    
    TensorInfo tensor_meta = tensor_meta_result.get();
    
    // Validate input size
    size_t expected_bytes = tensor_meta.nbytes();
    size_t provided_bytes = size * sizeof(float);
    
    if (provided_bytes != expected_bytes) {
        LOG_ERR("Input size mismatch for tensor %zu: expected %zu bytes, got %zu bytes",
                input_index, expected_bytes, provided_bytes);
        return Error::InvalidArgument;
    }
    
    // Create metadata arrays with persistent storage
    static std::vector<int32_t> sizes_storage[2];  // Support up to 2 input tensors
    static std::vector<uint8_t> dim_order_storage[2];
    static std::unique_ptr<TensorImpl> tensor_impls[2];  // Persistent storage for TensorImpl objects
    
    if (input_index >= 2) {
        LOG_ERR("Input index %zu exceeds supported maximum of 2", input_index);
        return Error::InvalidArgument;
    }
    
    // Copy metadata to persistent storage
    sizes_storage[input_index].assign(tensor_meta.sizes().begin(), tensor_meta.sizes().end());
    dim_order_storage[input_index].assign(tensor_meta.dim_order().begin(), tensor_meta.dim_order().end());
    
    // Create TensorImpl with persistent metadata using unique_ptr for proper lifecycle
    tensor_impls[input_index] = std::make_unique<TensorImpl>(
        ScalarType::Float,
        sizes_storage[input_index].size(),
        sizes_storage[input_index].data(),
        const_cast<void*>(static_cast<const void*>(data)),
        dim_order_storage[input_index].data()
    );
    
    // Create Tensor and EValue
    Tensor tensor(tensor_impls[input_index].get());
    EValue tensor_evalue(tensor);
    
    // Set input
    Error error = method.set_input(tensor_evalue, input_index);
    if (error != Error::Ok) {
        LOG_ERR("Failed to set input tensor %zu: %d", input_index, (int)error);
        return error;
    }
    
    LOG_DBG("Input tensor %zu set successfully", input_index);
    return Error::Ok;
}

Error ProgramLoader::runInference(const float* input1, const float* input2, size_t input_size,
                                 float* output, size_t output_size) {
    if (!isLoaded()) {
        LOG_ERR("Program not loaded");
        return Error::InvalidState;
    }
    
    Method& method = method_->get();
    
    LOG_INF("Running inference with inputs of size %zu", input_size);
    
    // Set input tensors
    Error error = createInputTensor(input1, input_size, 0);
    if (error != Error::Ok) {
        return error;
    }
    
    error = createInputTensor(input2, input_size, 1);
    if (error != Error::Ok) {
        return error;
    }
    
    // Execute the method
    error = method.execute();
    if (error != Error::Ok) {
        LOG_ERR("Method execution failed: %d", (int)error);
        return error;
    }
    
    LOG_INF("Method executed successfully");
    
    // Get output
    EValue output_evalue = method.get_output(0);
    if (!output_evalue.isTensor()) {
        LOG_ERR("Output is not a tensor");
        return Error::InvalidArgument;
    }
    
    Tensor output_tensor = output_evalue.toTensor();
    
    // Validate output size
    size_t expected_elements = output_tensor.numel();
    if (output_size < expected_elements) {
        LOG_ERR("Output buffer too small: need %zu elements, got %zu",
                expected_elements, output_size);
        return Error::InvalidArgument;
    }
    
    // Copy output data
    const float* output_data = output_tensor.const_data_ptr<float>();
    std::memcpy(output, output_data, expected_elements * sizeof(float));
    
    LOG_INF("Inference completed, output size: %zu elements", expected_elements);
    return Error::Ok;
} 
```

## src/program_loader.h
```c
#ifndef PROGRAM_LOADER_H
#define PROGRAM_LOADER_H

#include <executorch/extension/data_loader/buffer_data_loader.h>
#include <executorch/runtime/core/memory_allocator.h>
#include <executorch/runtime/executor/program.h>
#include <executorch/runtime/platform/platform.h>
#include <executorch/runtime/platform/runtime.h>

#include <memory>
#include <vector>

#include "arm_memory_allocator.hpp"

using executorch::aten::ScalarType;
using executorch::aten::Tensor;
using executorch::aten::TensorImpl;
using executorch::extension::BufferDataLoader;
using executorch::runtime::Error;
using executorch::runtime::EValue;
using executorch::runtime::HierarchicalAllocator;
using executorch::runtime::MemoryAllocator;
using executorch::runtime::MemoryManager;
using executorch::runtime::Method;
using executorch::runtime::MethodMeta;
using executorch::runtime::Program;
using executorch::runtime::Result;
using executorch::runtime::Span;
using executorch::runtime::Tag;
using executorch::runtime::TensorInfo;

/**
 * Simple program loader for ExecuTorch ARM Hello World sample
 * Loads embedded model and provides simple inference interface
 */
class ProgramLoader {
public:
    /**
     * Get singleton instance
     */
    static ProgramLoader& getInstance() {
        static ProgramLoader instance;
        return instance;
    }
    
    /**
     * Initialize the program loader (call once before first use)
     */
    void initialize();

    /**
     * Load the embedded program from model_pte.h
     * @return Error::Ok on success
     */
    Error loadProgram();

    /**
     * Run inference on the loaded model
     * @param input1 First input tensor data
     * @param input2 Second input tensor data  
     * @param input_size Size of input tensors
     * @param output Output tensor data
     * @param output_size Size of output tensor
     * @return Error::Ok on success
     */
    Error runInference(const float* input1, const float* input2, size_t input_size,
                      float* output, size_t output_size);

    /**
     * Check if program is loaded
     */
    bool isLoaded() const { return method_ != nullptr && method_->ok(); }

private:
    ProgramLoader();
    ~ProgramLoader() = default;
    
    // Disable copy/move
    ProgramLoader(const ProgramLoader&) = delete;
    ProgramLoader& operator=(const ProgramLoader&) = delete;
    ProgramLoader(ProgramLoader&&) = delete;
    ProgramLoader& operator=(ProgramLoader&&) = delete;

    /**
     * Create input tensor
     */
    Error createInputTensor(const float* data, size_t size, size_t input_index);

    // Initialization state
    bool initialized_;
    
    // Memory allocators
    std::unique_ptr<ArmMemoryAllocator> method_allocator_;
    std::unique_ptr<ArmMemoryAllocator> temp_allocator_;
    std::unique_ptr<MemoryManager> memory_manager_;
    std::unique_ptr<HierarchicalAllocator> planned_memory_;
    
    // ExecuTorch objects
    std::unique_ptr<Program> program_;
    std::unique_ptr<Result<Method>> method_;
    
    // Memory management
    std::vector<uint8_t*> planned_buffers_;
    std::vector<Span<uint8_t>> planned_spans_;
};

#endif // PROGRAM_LOADER_H
```
