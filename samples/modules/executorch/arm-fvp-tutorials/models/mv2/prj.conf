## CMakeLists.txt
```
cmake_minimum_required(VERSION 3.24)

# Use configuration overlay to disable default portable ops to enable selective operator build
set(CONF_FILE "${CMAKE_CURRENT_SOURCE_DIR}/prj.conf")

find_package(Zephyr REQUIRED HINTS $ENV{ZEPHYR_BASE})
project(executorch_hello_world)

set(CMAKE_CXX_FLAGS "${CMAKE_CXX_FLAGS} -Wall -Wno-switch -Wno-float-conversion -Wno-double-promotion -ffunction-sections -fdata-sections")

# Always use selective build since embedded devices are resource constrained
    
# Include ExecuTorch selective build utilities
# Use EXECUTORCH_DIR if available, otherwise use Zephyr's module discovery
if(NOT DEFINED EXECUTORCH_DIR)
    message(STATUS "ZEPHYR_EXECUTORCH_MODULE_DIR set to : ${ZEPHYR_EXECUTORCH_MODULE_DIR}")
    if(DEFINED ZEPHYR_EXECUTORCH_MODULE_DIR)
        set(EXECUTORCH_DIR ${ZEPHYR_EXECUTORCH_MODULE_DIR})
        message(STATUS "Using Zephyr module discovery: EXECUTORCH_DIR=${EXECUTORCH_DIR}")
    else()
        message(FATAL_ERROR "ExecutorTorch module not found. Ensure it's properly configured in your Zephyr workspace.")
    endif()
else()
    message(STATUS "Using predefined EXECUTORCH_DIR=${EXECUTORCH_DIR}")
endif()
    
# Set EXECUTORCH_ROOT for the Codegen.cmake file 
set(EXECUTORCH_ROOT ${EXECUTORCH_DIR})
    
include(${EXECUTORCH_DIR}/tools/cmake/Utils.cmake)
include(${EXECUTORCH_DIR}/tools/cmake/Codegen.cmake)
    
set(EXECUTORCH_OPS_LIB selective_portable_ops_lib)
set(EXECUTORCH_SRCS_FILE "${CMAKE_CURRENT_BINARY_DIR}/modules/executorch/executorch/executorch_srcs.cmake")
include(${EXECUTORCH_SRCS_FILE})

if(DEFINED ET_PTE_FILE_PATH_FOR_SELECTIVE_BUILD)
    gen_selected_ops(
        LIB_NAME "${EXECUTORCH_OPS_LIB}" 
	OPS_FROM_MODEL "${ET_PTE_FILE_PATH_FOR_SELECTIVE_BUILD}"
        DTYPE_SELECTIVE_BUILD "ON"
    )
    generate_bindings_for_kernels(
        LIB_NAME "${EXECUTORCH_OPS_LIB}" 
        FUNCTIONS_YAML "${EXECUTORCH_ROOT}/kernels/portable/functions.yaml"
    )
    gen_operators_lib(
        LIB_NAME "${EXECUTORCH_OPS_LIB}" 
        KERNEL_LIBS portable_kernels
        DEPS executorch_core
        DTYPE_SELECTIVE_BUILD "ON"
    )
else()
    gen_selected_ops(
        LIB_NAME "${EXECUTORCH_OPS_LIB}" 
        INCLUDE_ALL_OPS "ON"
    )

    generate_bindings_for_kernels(
        LIB_NAME "${EXECUTORCH_OPS_LIB}" 
        FUNCTIONS_YAML "${EXECUTORCH_ROOT}/kernels/portable/functions.yaml"
    )
   
    gen_operators_lib(
        LIB_NAME "${EXECUTORCH_OPS_LIB}" 
        KERNEL_LIBS portable_kernels
        DEPS executorch_core
    )
endif()
    
# Use our custom selective operators library
message(STATUS "Using selective operators library: ${EXECUTORCH_OPS_LIB}")

set(app_sources
    src/arm_executor_runner.cpp
    src/mv2_output_verifier.cpp
    ${EXECUTORCH_DIR}/examples/arm/executor_runner/arm_memory_allocator.cpp
    ${EXECUTORCH_DIR}/examples/arm/executor_runner/arm_perf_monitor.cpp
    ${EXECUTORCH_DIR}/runtime/platform/default/arm_zephyr.cpp
)
    #../output_verifier.cpp
target_sources(app PRIVATE ${app_sources})
target_include_directories(app PRIVATE "${CMAKE_CURRENT_SOURCE_DIR}/../")
target_include_directories(app PRIVATE "${CMAKE_CURRENT_SOURCE_DIR}/src/")

if(DEFINED CONFIG_EXECUTORCH_METHOD_ALLOCATOR_POOL_SIZE)
    target_compile_definitions(app PRIVATE ET_ARM_METHOD_ALLOCATOR_POOL_SIZE=${CONFIG_EXECUTORCH_METHOD_ALLOCATOR_POOL_SIZE})
endif()

zephyr_linker_sources(SECTIONS "${CMAKE_CURRENT_SOURCE_DIR}/../mps3_corstone300_fvp_relocation.ld")
zephyr_linker_sources(SECTIONS "${CMAKE_CURRENT_SOURCE_DIR}/imagenet_relocation.ld")
if (CONFIG_CODE_DATA_RELOCATION)
    # Relocation the Executorch portable operator library to partition S2 of DD4
    file(GLOB_RECURSE ET_OP_SRC_FILES ${EXECUTORCH_ROOT}/*.cpp )
    zephyr_code_relocate(FILES ${ET_OP_SRC_FILES} LOCATION DDR4S2_TEXT_RODATA NOCOPY)
endif()

if(CONFIG_EXECUTORCH_INCLUDE_ARM_QUANTIZE_LIBS)
    executorch_kernel_link_options(quantized_kernels)
    executorch_kernel_link_options(quantized_ops_lib)
    executorch_kernel_link_options(cortex_m_kernels)
    executorch_kernel_link_options(cortex_m_ops_lib)
endif()

# Link with ExecuTorch and our operators library
target_link_libraries(app PRIVATE 
    libexecutorch
    ${EXECUTORCH_OPS_LIB}
)
if(CONFIG_EXECUTORCH_INCLUDE_ARM_QUANTIZE_LIBS)
    target_link_libraries(app PRIVATE 
        quantized_kernels
        quantized_ops_lib
        cortex_m_kernels
        cortex_m_ops_lib
    )
endif()

# Add include directory for generated headers
target_include_directories(app PRIVATE src) 
get_target_property(OUT app LINK_LIBRARIES)
message(STATUS ${OUT})
```

## prj.conf
```kconfig
# Enable ExecuTorch
CONFIG_EXECUTORCH=y
CONFIG_EXECUTORCH_BACKEND_ARM=y

# C++
CONFIG_CPP=y
CONFIG_STD_CPP17=y
CONFIG_NEWLIB_LIBC=y

# Config - increased for ExecuTorch memory requirements
CONFIG_MAIN_STACK_SIZE=8192
CONFIG_HEAP_MEM_POOL_SIZE=32768
CONFIG_REQUIRES_FLOAT_PRINTF=y

# Configuration for selective operator builds
# Disable default portable operators registry when using selective operators
# (portable kernels will be automatically built to support selective builds)
CONFIG_EXECUTORCH_BUILD_PORTABLE_OPS=n 

# Logging
CONFIG_LOG=y
CONFIG_LOG_PRINTK=y
CONFIG_LOG_BACKEND_UART=y
CONFIG_CBPRINTF_FP_SUPPORT=y

# Allow usage of non itcm memory to relocate operator code elsewhere
CONFIG_CODE_DATA_RELOCATION=y

# Add model specific configs, mv2 needs at least ~11 MB, quantized needs 12MB?
CONFIG_EXECUTORCH_METHOD_ALLOCATOR_POOL_SIZE=11534336
CONFIG_EXECUTORCH_INCLUDE_ARM_QUANTIZE_LIBS=n
#CONFIG_EXECUTORCH_METHOD_ALLOCATOR_POOL_SIZE=12582912
    
```

## src/arm_executor_runner.cpp
```c
/* Copyright (c) Meta Platforms, Inc. and affiliates.
 * All rights reserved.
 * Copyright 2023-2025 Arm Limited and/or its affiliates.
 *
 * This source code is licensed under the BSD-style license found in the
 * LICENSE file in the root directory of this source tree.
 */

#include <errno.h>
#include <executorch/examples/arm/executor_runner/arm_memory_allocator.h>
#include <executorch/examples/arm/executor_runner/arm_perf_monitor.h>
#include <executorch/extension/data_loader/buffer_data_loader.h>
#include <executorch/extension/runner_util/inputs.h>
#include <executorch/runtime/core/memory_allocator.h>
#include <executorch/runtime/executor/program.h>
#include <executorch/runtime/platform/log.h>
#include <executorch/runtime/platform/platform.h>
#include <executorch/runtime/platform/runtime.h>
#include <stdio.h>
#include <unistd.h>
#include <math.h>
#include <memory>
#include <cmath>
#include <vector>
#include <zephyr/kernel.h>
#include <zephyr/sys/printk.h>

/**
 * This header file is generated by the build process based on the .pte file
 * specified in the ET_PTE_FILE_PATH variable to the cmake build.
 * Control of the action of the .pte, it's use of operators and delegates, and
 * which are included in the bare metal build are also orchestrated by the
 * CMakeLists file. For example use see examples/arm/run.sh
 *
 * e.g. This includes the pte as a big chunk of data struct into this file
 */
#include "model_pte.h"
//#include "imagenet_classes.h"
#include "samoyed_dog_tensor_input.h"
#include "mv2_output_verifier.hpp"
union FloatBytes {
    float f;
    char bytes[sizeof(float)];
};

using executorch::aten::ScalarType;
using executorch::aten::Tensor;
using executorch::aten::TensorImpl;
using executorch::extension::BufferCleanup;
using executorch::extension::BufferDataLoader;
using executorch::runtime::Error;
using executorch::runtime::EValue;
using executorch::runtime::HierarchicalAllocator;
using executorch::runtime::MemoryAllocator;
using executorch::runtime::MemoryManager;
using executorch::runtime::Method;
using executorch::runtime::MethodMeta;
using executorch::runtime::Program;
using executorch::runtime::Result;
using executorch::runtime::Span;
using executorch::runtime::Tag;
using executorch::runtime::TensorInfo;

/**
 * The method_allocation_pool should be large enough to fit the setup, input
 * used and other data used like the planned memory pool (e.g. memory-planned
 * buffers to use for mutable tensor data) In this example we run on a
 * Corstone-3xx FVP so we can use a lot of memory to be able to run and test
 * large models if you run on HW this should be lowered to fit into your
 * availible memory.
 */

#if !defined(ET_ARM_METHOD_ALLOCATOR_POOL_SIZE)
#define ET_ARM_METHOD_ALLOCATOR_POOL_SIZE (160 * 1024 * 1024)
#endif
const size_t method_allocation_pool_size = ET_ARM_METHOD_ALLOCATOR_POOL_SIZE;
unsigned char __attribute__((
    section("input_data_sec"),
    aligned(16))) method_allocation_pool[method_allocation_pool_size];

//unsigned char method_allocation_pool[method_allocation_pool_size];

/**
 * The temp_allocation_pool is used for allocating temporary data during kernel
 * or delegate execution. This will be reset after each kernel or delegate call.
 * Currently a MemoryAllocator is used but a PlatformMemoryAllocator is probably
 * a better fit.
 *
 * The Corstone-300/Corstone-320 platforms have 2MB/4MB of SRAM respectively.
 * For Shared_Sram, ET_ARM_BAREMETAL_SCRATCH_TEMP_ALLOCATOR_POOL_SIZE is
 * 2MB and the linker script places the .bss.tensor_arena symbol in the SRAM.
 * For Dedicated_Sram, the .bss.tensor_arena symbol is placed in the DDR in the
 * linker script. Hence, we allocate 128MB in DDR and 384KB in the SRAM
 * (.bss.ethosu_scratch is placed in the SRAM). The examples/arm/CMakeLists.txt
 * contains the logic for the sizes of
 * ET_ARM_BAREMETAL_SCRATCH_TEMP_ALLOCATOR_POOL_SIZE and
 * ET_ARM_BAREMETAL_FAST_SCRATCH_TEMP_ALLOCATOR_POOL_SIZE
 */

#define ET_ARM_BAREMETAL_SCRATCH_TEMP_ALLOCATOR_POOL_SIZE 2048
#define ET_ARM_BAREMETAL_FAST_SCRATCH_TEMP_ALLOCATOR_POOL_SIZE 0x600

const size_t temp_allocation_pool_size =
    ET_ARM_BAREMETAL_SCRATCH_TEMP_ALLOCATOR_POOL_SIZE;
unsigned char __attribute__((
    section(".bss.tensor_arena"),
    aligned(16))) temp_allocation_pool[temp_allocation_pool_size];
#if defined(ET_ARM_BAREMETAL_FAST_SCRATCH_TEMP_ALLOCATOR_POOL_SIZE)
extern "C" {
size_t ethosu_fast_scratch_size =
    ET_ARM_BAREMETAL_FAST_SCRATCH_TEMP_ALLOCATOR_POOL_SIZE;
unsigned char __attribute__((section(".bss.ethosu_scratch"), aligned(16)))
dedicated_sram[ET_ARM_BAREMETAL_FAST_SCRATCH_TEMP_ALLOCATOR_POOL_SIZE];
unsigned char* ethosu_fast_scratch = dedicated_sram;
}
#endif

namespace {

Result<BufferCleanup> prepare_input_tensors(
    Method& method,
    MemoryAllocator& allocator,
    std::vector<std::pair<char*, size_t>>& input_buffers) {
  MethodMeta method_meta = method.method_meta();
  size_t num_inputs = method_meta.num_inputs();
  size_t num_allocated = 0;

  void** inputs =
      static_cast<void**>(allocator.allocate(num_inputs * sizeof(void*)));
  ET_CHECK_OR_RETURN_ERROR(
      inputs != nullptr,
      MemoryAllocationFailed,
      "Could not allocate memory for pointers to input buffers.");

  for (size_t i = 0; i < num_inputs; i++) {
    auto tag = method_meta.input_tag(i);
    ET_CHECK_OK_OR_RETURN_ERROR(tag.error());

    if (tag.get() != Tag::Tensor) {
      ET_LOG(Debug, "Skipping non-tensor input %zu", i);
      continue;
    }
    Result<TensorInfo> tensor_meta = method_meta.input_tensor_meta(i);
    ET_CHECK_OK_OR_RETURN_ERROR(tensor_meta.error());

    // Input is a tensor. Allocate a buffer for it.
    void* data_ptr = allocator.allocate(tensor_meta->nbytes());
    ET_CHECK_OR_RETURN_ERROR(
        data_ptr != nullptr,
        MemoryAllocationFailed,
        "Could not allocate memory for input buffers.");
    inputs[num_allocated++] = data_ptr;

    Error err = Error::Ok;
    if (input_buffers.size() > 0) {
      auto [buffer, buffer_size] = input_buffers.at(i);
      if (buffer_size != tensor_meta->nbytes()) {
        ET_LOG(
            Error,
            "input size (%d) and tensor size (%d) missmatch!",
            buffer_size,
            tensor_meta->nbytes());
        err = Error::InvalidArgument;
      } else {
        ET_LOG(Info, "Copying read input to tensor.");
        std::memcpy(data_ptr, buffer, buffer_size);
      }
    }

    TensorImpl impl = TensorImpl(
        tensor_meta.get().scalar_type(),
        tensor_meta.get().sizes().size(),
        const_cast<TensorImpl::SizesType*>(tensor_meta.get().sizes().data()),
        data_ptr,
        const_cast<TensorImpl::DimOrderType*>(
            tensor_meta.get().dim_order().data()));
    Tensor t(&impl);

    // If input_buffers.size <= 0, we don't have any input, fill t with 1's.
    if (input_buffers.size() <= 0) {
      for (size_t j = 0; j < t.numel(); j++) {
        switch (t.scalar_type()) {
          case ScalarType::Int:
            t.mutable_data_ptr<int>()[j] = 1;
            break;
          case ScalarType::Float:
            t.mutable_data_ptr<float>()[j] = 1.;
            break;
          case ScalarType::Char:
            t.mutable_data_ptr<int8_t>()[j] = 1;
            break;
        }
      }
    }

    err = method.set_input(t, i);

    if (err != Error::Ok) {
      ET_LOG(
          Error, "Failed to prepare input %zu: 0x%" PRIx32, i, (uint32_t)err);
      // The BufferCleanup will free the inputs when it goes out of scope.
      BufferCleanup cleanup({inputs, num_allocated});
      return err;
    }
  }
  return BufferCleanup({inputs, num_allocated});
}

} // namespace

int main(int argc, const char* argv[]) {
  (void)argc;
  (void)argv;

  executorch::runtime::runtime_init();
  std::vector<std::pair<char*, size_t>> input_buffers;
  size_t pte_size = sizeof(model_pte);

  ET_LOG(
      Info, "PTE at %p Size: %lu bytes", model_pte, pte_size);

  // Find the offset to the embedded Program.
  const void* program_data = model_pte;
  size_t program_data_len = pte_size;

  auto loader = BufferDataLoader(program_data, program_data_len);
  ET_LOG(Info, "PTE Model data loaded. Size: %lu bytes.", program_data_len);

  // Parse the program file. This is immutable, and can also be reused
  // between multiple execution invocations across multiple threads.
  Result<Program> program = Program::load(&loader);
  if (!program.ok()) {
    ET_LOG(
        Info,
        "Program loading failed @ 0x%p: 0x%" PRIx32,
        program_data,
        program.error());
  }

  ET_LOG(Info, "Model buffer loaded, has %lu methods", program->num_methods());

  const char* method_name = nullptr;
  {
    const auto method_name_result = program->get_method_name(0);
    ET_CHECK_MSG(method_name_result.ok(), "Program has no methods");
    method_name = *method_name_result;
  }
  ET_LOG(Info, "Running method %s", method_name);

  Result<MethodMeta> method_meta = program->method_meta(method_name);
  if (!method_meta.ok()) {
    ET_LOG(
        Info,
        "Failed to get method_meta for %s: 0x%x",
        method_name,
        (unsigned int)method_meta.error());
  }

  ET_LOG(
      Info,
      "Setup Method allocator pool. Size: %lu bytes.",
      method_allocation_pool_size);

  ArmMemoryAllocator method_allocator(
      method_allocation_pool_size, method_allocation_pool);

  std::vector<uint8_t*> planned_buffers; // Owns the memory
  std::vector<Span<uint8_t>> planned_spans; // Passed to the allocator
  size_t num_memory_planned_buffers = method_meta->num_memory_planned_buffers();

  size_t planned_buffer_membase = method_allocator.used_size();

  for (size_t id = 0; id < num_memory_planned_buffers; ++id) {
    size_t buffer_size =
        static_cast<size_t>(method_meta->memory_planned_buffer_size(id).get());
    ET_LOG(Info, "Setting up planned buffer %zu, size %zu.", id, buffer_size);

    /* Move to it's own allocator when MemoryPlanner is in place. */
    uint8_t* buffer =
        reinterpret_cast<uint8_t*>(method_allocator.allocate(buffer_size));
    ET_CHECK_MSG(
        buffer != nullptr,
        "Could not allocate memory for memory planned buffer size %zu",
        buffer_size);
    planned_buffers.push_back(buffer);
    planned_spans.push_back({planned_buffers.back(), buffer_size});
  }

  size_t planned_buffer_memsize =
      method_allocator.used_size() - planned_buffer_membase;
  ET_LOG(Info, "Computed planned buffer size=%zu", planned_buffer_memsize);

  HierarchicalAllocator planned_memory(
      {planned_spans.data(), planned_spans.size()});

  ArmMemoryAllocator temp_allocator(
      temp_allocation_pool_size, temp_allocation_pool);

  MemoryManager memory_manager(
      &method_allocator, &planned_memory, &temp_allocator);

  size_t method_loaded_membase = method_allocator.used_size();

  executorch::runtime::EventTracer* event_tracer_ptr = nullptr;

  ET_LOG(Info, "Loading method.");
  Result<Method> method =
      program->load_method(method_name, &memory_manager, event_tracer_ptr);

  if (!method.ok()) {
    ET_LOG(
        Info,
        "Loading of method %s failed with status 0x%" PRIx32,
        method_name,
        method.error());
  }
  size_t method_loaded_memsize =
      method_allocator.used_size() - method_loaded_membase;
  ET_LOG(Info, "Method '%s' loaded.", method_name);

  size_t input_membase = method_allocator.used_size();
  ET_LOG(Info, "Preparing input: In use: %zuB, Free: %zuB", input_membase, method_allocator.free_size());

  {
    // Here you would add code to get input from your Hardware
    // Get inputs from SEMIHOSTING or fake it with a lot of "1"
    // Use "static" to force to compiler to remove this when it goes out of
    // scope
    static auto prepared_inputs =
        ::prepare_input_tensors(*method, method_allocator, input_buffers);

    if (!prepared_inputs.ok()) {
      ET_LOG(
          Info,
          "Preparing inputs tensors for method %s failed with status 0x%" PRIx32,
          method_name,
          prepared_inputs.error());
    }
  }
  std::vector<EValue> inputs(method->inputs_size());
  ET_LOG(Info, "%zu inputs: ", inputs.size());
  Error status = method->get_inputs(inputs.data(), inputs.size());
  ET_CHECK(status == Error::Ok);
  ET_LOG(Info, "Reading input image from header file");
  int input_cursor = 0;
  union FloatBytes cursor_data;
  for (int i = 0; i < inputs.size(); ++i) {
      if (inputs[i].isTensor()) {
          Tensor tensor = inputs[i].toTensor();
          for (int j = 0; j < tensor.numel(); ++j) {
              if (tensor.scalar_type() == ScalarType::Float) {
		  cursor_data.bytes[0] = samoyed_dog_tensor_input_bin[input_cursor++];
                  cursor_data.bytes[1] = samoyed_dog_tensor_input_bin[input_cursor++];
                  cursor_data.bytes[2] = samoyed_dog_tensor_input_bin[input_cursor++];
                  cursor_data.bytes[3] = samoyed_dog_tensor_input_bin[input_cursor++];
                  tensor.data_ptr<float>()[j] = cursor_data.f;
	      }
	  }
      }
  }
#if defined(ET_DUMP_INPUT)
  {

    for (int i = 0; i < inputs.size(); ++i) {
      if (inputs[i].isTensor()) {
        Tensor tensor = inputs[i].toTensor();
        // The output might be collected and parsed so printf() is used instead
        // of ET_LOG() here
        for (int j = 0; j < tensor.numel(); ++j) {
          if (tensor.scalar_type() == ScalarType::Int) {
            printf(
                "Input[%d][%d]: (int) %d\n",
                i,
                j,
                tensor.const_data_ptr<int>()[j]);
          } else if (tensor.scalar_type() == ScalarType::Float) {
            printf(
                "Input[%d][%d]: (float) %f\n",
                i,
                j,
                tensor.const_data_ptr<float>()[j]);
          } else if (tensor.scalar_type() == ScalarType::Char) {
            printf(
                "Input[%d][%d]: (char) %d\n",
                i,
                j,
                tensor.const_data_ptr<int8_t>()[j]);
          } else if (tensor.scalar_type() == ScalarType::Bool) {
            printf(
                "Input[%d][%d]: (bool) %s (0x%x)\n",
                i,
                j,
                tensor.const_data_ptr<int8_t>()[j] ? "true" : "false",
                tensor.const_data_ptr<int8_t>()[j]);
          }
        }
      } else {
        printf("Input[%d]: Not Tensor\n", i);
      }
    }
  }
#endif
  size_t input_memsize = method_allocator.used_size() - input_membase;
  ET_LOG(Info, "Input prepared.");

  ET_LOG(Info, "Starting the model execution...");
  size_t executor_membase = method_allocator.used_size();
  // Run the model.
  status = method->execute();
  size_t executor_memsize = method_allocator.used_size() - executor_membase;

  ET_LOG(Info, "model_pte_program_size:     %lu bytes.", program_data_len);
  ET_LOG(Info, "model_pte_loaded_size:      %lu bytes.", pte_size);
  if (method_allocator.size() != 0) {
    size_t method_allocator_used = method_allocator.used_size();
    ET_LOG(
        Info,
        "method_allocator_used:     %zu / %zu  free: %zu ( used: %zu %% ) ",
        method_allocator_used,
        method_allocator.size(),
        method_allocator.free_size(),
        100 * method_allocator_used / method_allocator.size());
    ET_LOG(
        Info, "method_allocator_planned:  %zu bytes", planned_buffer_memsize);
    ET_LOG(Info, "method_allocator_loaded:   %zu bytes", method_loaded_memsize);
    ET_LOG(Info, "method_allocator_input:    %zu bytes", input_memsize);
    ET_LOG(Info, "method_allocator_executor: %zu bytes", executor_memsize);
  }
  if (temp_allocator.size() > 0) {
    ET_LOG(
        Info,
        "peak_temp_allocator:       %zu / %zu free: %zu ( used: %zu %% ) ",
        temp_allocator.peak_used(),
        temp_allocator.size(),
        temp_allocator.free_size(),
        100 * temp_allocator.peak_used() / temp_allocator.size());
  }

  if (status != Error::Ok) {
    ET_LOG(
        Info,
        "Execution of method %s failed with status 0x%" PRIx32,
        method_name,
        status);
  } else {
    ET_LOG(Info, "Model executed successfully.");
  }

  std::vector<EValue> outputs(method->outputs_size());
  status = method->get_outputs(outputs.data(), outputs.size());
  ET_CHECK(status == Error::Ok);

  // Verfiication of Outputs (model specific)
  ET_LOG(Info, "Beginning output verificaiton");
  MV2OutputVerifier *ov = reinterpret_cast<MV2OutputVerifier*>(method_allocator.allocate(sizeof(OutputVerifier)));
  if (ov->verify(outputs)) {
      ET_LOG(Error, "ERROR: Output verifier reported failure");
      return 1;
  }
  ET_LOG(Info, "SUCCESS: Program complete, exiting.");
  ET_LOG(Info, "\04");
  return 0;
}
```

## src/mv2_output_verifier.cpp
```c
#include "mv2_output_verifier.hpp" 

#include <cmath>
#include <string.h>

#include "imagenet_classes.h"

MV2OutputVerifier::MV2OutputVerifier(void) {
}

float
MV2OutputVerifier:: _max(std::vector<executorch::runtime::EValue>& outputs) {
    float max_val = 0;
    bool max_val_set = false;
    for (size_t i = 0; i < outputs.size(); ++i) {
        assert(outputs[i].isTensor());
        executorch::aten::Tensor tensor = outputs[i].toTensor();
        for (int j = 0; j < tensor.numel(); ++j) {
            assert(tensor.scalar_type() == executorch::aten::ScalarType::Float);
            float value  = tensor.const_data_ptr<float>()[j];
	    if (!max_val_set || value > max_val) {
                max_val = value;
		max_val_set = true;
	    }
        }
    }
    return max_val;
}

void 
MV2OutputVerifier::_softmax_in_place(std::vector<executorch::runtime::EValue>& outputs, float max_val) {
    double sum_exp = 0.0;
    for (size_t i = 0; i < outputs.size(); ++i) {
        assert(outputs[i].isTensor());
        executorch::aten::Tensor tensor = outputs[i].toTensor();
	// First pass to determine sum_exp
        for (int j = 0; j < tensor.numel(); ++j) {
            assert(tensor.scalar_type() == executorch::aten::ScalarType::Float);
            float value  = tensor.const_data_ptr<float>()[j];
            tensor.data_ptr<float>()[j] = exp(value - max_val);
	    sum_exp += tensor.const_data_ptr<float>()[j];
        }
	// Second pass to normalize to sum_exp
        for (int j = 0; j < tensor.numel(); ++j) {
            float value  = tensor.const_data_ptr<float>()[j];
            tensor.data_ptr<float>()[j] = value / sum_exp;
        }
    }
}

void 
MV2OutputVerifier::_top_k(std::vector<executorch::runtime::EValue>& in_probs, 
		size_t k, std::vector<float>& out_probs, std::vector<size_t>& out_idxs) {
    assert(out_probs.size() == 0);
    assert(out_idxs.size() == 0);
    for (size_t i = 0; i < in_probs.size(); ++i) {
        executorch::aten::Tensor tensor = in_probs[i].toTensor();
        for (int j = 0; j < tensor.numel(); ++j) {
            float value  = tensor.const_data_ptr<float>()[j];
	    if (out_probs.size() == 0) {
	        out_probs.push_back(value);
		out_idxs.push_back((i * tensor.numel()) + j);
	    } else if (out_probs.size() == 1) {
	        if (value > out_probs[0]) {
		    out_probs.insert(out_probs.begin(), value);
		    out_idxs.insert(out_idxs.begin(), (i * tensor.numel()) + j);
		} else {
	            out_probs.push_back(value);
		    out_idxs.push_back((i * tensor.numel()) + j);
		}
	    } else if (out_probs.size() == 2) {
	        if (value > out_probs[0]) {
		    out_probs.insert(out_probs.begin(), value);
		    out_idxs.insert(out_idxs.begin(), (i * tensor.numel()) + j);
		} else if (value > out_probs[1]){
		    out_probs.insert(out_probs.begin() + 1, value);
		    out_idxs.insert(out_idxs.begin() + 1, (i * tensor.numel()) + j);
		} else {
	            out_probs.push_back(value);
		    out_idxs.push_back((i * tensor.numel()) + j);
		}
	    } else {
                assert(out_probs.size() == 3);
	        if (value > out_probs[0]) {
		    out_probs.insert(out_probs.begin(), value);
		    out_idxs.insert(out_idxs.begin(), (i * tensor.numel()) + j);
		} else if (value > out_probs[1]){
		    out_probs.insert(out_probs.begin() + 1, value);
		    out_idxs.insert(out_idxs.begin() + 1, (i * tensor.numel()) + j);
		} else if (value > out_probs[2]){
		    out_probs.insert(out_probs.begin() + 2, value);
		    out_idxs.insert(out_idxs.begin() + 2, (i * tensor.numel()) + j);
		} else {
	            out_probs.push_back(value);
		    out_idxs.push_back((i * tensor.numel()) + j);
		}
		out_probs.pop_back();
		out_idxs.pop_back();
	    }
        }
    }
}

void 
MV2OutputVerifier::_get_class(size_t idx, char *name_buf, size_t buf_len) {
    unsigned int name_idx = 0;
    unsigned int name_char_idx = 0;
    for(unsigned int i = 0; i < imagenet_classes_txt_len; i++) {
        if (name_idx == idx) {
	    assert(name_char_idx < buf_len);
            if (imagenet_classes_txt[i] == '\n') {
                name_buf[name_char_idx++] = '\0';
	        break;
	    } else {
                name_buf[name_char_idx++] = imagenet_classes_txt[i];
	    }
        }
        if(imagenet_classes_txt[i] == '\n') {
            name_idx++;
        }
    }
}
void
MV2OutputVerifier::_print(std::vector<executorch::runtime::EValue>& outputs) {
  // Print the outputs.
  ET_LOG(Info, "Printing outputs.");
  for (int i = 0; i < outputs.size(); ++i) {
    if (outputs[i].isTensor()) {
      executorch::aten::Tensor tensor = outputs[i].toTensor();
      // The output might be collected and parsed so printf() is used instead
      // of ET_LOG() here
      for (int j = 0; j < tensor.numel(); ++j) {
        if (tensor.scalar_type() == executorch::aten::ScalarType::Int) {
          printf(
              "Output[%d][%d]: (int) %d\n",
              i,
              j,
              tensor.const_data_ptr<int>()[j]);
        } else if (tensor.scalar_type() == executorch::aten::ScalarType::Float) {
          printf(
              "Output[%d][%d]: (float) %f\n",
              i,
              j,
              tensor.const_data_ptr<float>()[j]);
        } else if (tensor.scalar_type() == executorch::aten::ScalarType::Char) {
          printf(
              "Output[%d][%d]: (char) %d\n",
              i,
              j,
              tensor.const_data_ptr<int8_t>()[j]);
        } else if (tensor.scalar_type() == executorch::aten::ScalarType::Bool) {
          printf(
              "Output[%d][%d]: (bool) %s (0x%x)\n",
              i,
              j,
              tensor.const_data_ptr<int8_t>()[j] ? "true " : "false",
              tensor.const_data_ptr<int8_t>()[j]);
        }
      }
    } else {
      printf("Output[%d]: Not Tensor\n", i);
    }
  }
}

int
MV2OutputVerifier::verify(std::vector<executorch::runtime::EValue>& outputs) {
    if (outputs.size() != 1) {
        ET_LOG(Error, "ERROR: Incorrect top level dim of output size (%zu != 1)", outputs.size());
	return 1;
    }
    if (!outputs[0].isTensor()) {
        ET_LOG(Error, "ERROR: Expected output[0] to return a tesnor but got something else");
	return 1;
    }
    executorch::aten::Tensor tensor = outputs[0].toTensor();
    if (tensor.numel() != 1000) {
        ET_LOG(Error, "ERROR: Incorrect lower level dim of output (%zu != 1000)", tensor.numel());
	return 1;
    }
    size_t top_k = 3;
    std::vector<float> top_k_probs;
    std::vector<size_t> top_k_idxs;
    top_k_probs.reserve(top_k + 1);
    top_k_idxs.reserve(top_k + 1);

    float max_val = _max(outputs);
    ET_LOG(Info, "max_val from verifier is %f", max_val);
    _softmax_in_place(outputs, max_val);
    _top_k(outputs, top_k, top_k_probs, top_k_idxs);

    char class_name[256];
    memset(class_name, 0, sizeof(class_name));
    for (size_t i = 0; i < top_k; i++) {
	_get_class(top_k_idxs[i], class_name, 256);
        ET_LOG(Info, "Predicted top %u class (%d,%f)->%s", 
			i, 
			top_k_idxs[i], 
			top_k_probs[i],
			class_name);
        memset(class_name, 0, sizeof(class_name));
    }
    float expected_probs[3] = {0.397523,0.043148,0.035979};
    int expected_idxs[3] = {258,259,279};
    for (int i = 0; i < 3; i++) {
        float prob = top_k_probs[i];
        int idx = top_k_idxs[i];

        if (fabs(prob - expected_probs[i]) >= 0.00001f) {
            ET_LOG(Error, "ERROR: Incorrect probability top %zu predicted label (%f != %f)", i, prob, expected_probs[i]);
	    return 1;
        }
        if (idx != expected_idxs[i]) {
            ET_LOG(Error, "ERROR: Incorrect label choice for top %zu predicted label (%d != %d)", i, idx, expected_idxs[i]);
	    return 1;
        }
    }
    return 0;
}
```

## src/mv2_output_verifier.hpp
```c
#ifndef __MV2_OUTPUT_VERIFICATION_H__
#define __MV2_OUTPUT_VERIFICATION_H__

#include <executorch/runtime/core/memory_allocator.h>
#include <executorch/runtime/executor/program.h>
#include <executorch/runtime/platform/log.h>
#include <executorch/runtime/platform/platform.h>
#include <executorch/runtime/platform/runtime.h>
#include <executorch/runtime/platform/log.h>
#include <vector>

#include "output_verifier.hpp"

class MV2OutputVerifier : public OutputVerifier {
    public:
        MV2OutputVerifier(void);
        int verify(std::vector<executorch::runtime::EValue>& outputs);
    private:
	float _max(std::vector<executorch::runtime::EValue>& outputs);
	void _softmax_in_place(std::vector<executorch::runtime::EValue>& outputs, float max_val);
	void _top_k(std::vector<executorch::runtime::EValue>& in_probs, size_t k, std::vector<float>& out_probs, std::vector<size_t>& out_idxs);
	void _get_class(size_t idx, char *name_buf, size_t buf_len);
};
#endif //__MV2_OUTPUT_VERIFICATION_H__
```
