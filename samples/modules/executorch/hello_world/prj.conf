## CMakeLists.txt
```
cmake_minimum_required(VERSION 3.24)

find_package(Zephyr REQUIRED HINTS $ENV{ZEPHYR_BASE})
project(executorch_hello_world)

set(CMAKE_CXX_FLAGS "${CMAKE_CXX_FLAGS} -Wall -Wno-switch -Wno-float-conversion -Wno-double-promotion")

# Use EXECUTORCH_DIR if available, otherwise use Zephyr's module discovery
if(NOT DEFINED EXECUTORCH_DIR)
    if(DEFINED ZEPHYR_EXECUTORCH_MODULE_DIR)
        set(EXECUTORCH_DIR ${ZEPHYR_EXECUTORCH_MODULE_DIR})
        message(STATUS "Using Zephyr module discovery: EXECUTORCH_DIR=${EXECUTORCH_DIR}")
    else()
        message(FATAL_ERROR "ExecutorTorch module not found. Ensure it's properly configured in your Zephyr workspace.")
    endif()
else()
    message(STATUS "Using predefined EXECUTORCH_DIR=${EXECUTORCH_DIR}")
endif()

# Get model filename from Kconfig
if(NOT DEFINED CONFIG_EXECUTORCH_MODEL_NAME)
    set(CONFIG_EXECUTORCH_MODEL_NAME "model_add.pte")
endif()

# Detect target architecture and configure backend accordingly
if(CONFIG_ARM OR CONFIG_ARM64)
    set(EXECUTORCH_USE_ARM_BACKEND TRUE)
    set(EXECUTORCH_BACKEND_TYPE "ARM")
    message(STATUS "Using ARM backend for ExecuTorch")
elseif(CONFIG_ARCH_POSIX OR "${BOARD}" MATCHES "native")
    set(EXECUTORCH_USE_PORTABLE_BACKEND TRUE)
    set(EXECUTORCH_BACKEND_TYPE "Portable")
    message(STATUS "Using Portable backend for ExecuTorch (native/POSIX target)")
else()
    # Default to portable backend for other architectures
    set(EXECUTORCH_USE_PORTABLE_BACKEND TRUE)
    set(EXECUTORCH_BACKEND_TYPE "Portable")
    message(STATUS "Using Portable backend for ExecuTorch (default)")
endif()

# Define output files that will be generated in the build directory
set(GENERATED_OPS_DEF_FILE "${CMAKE_CURRENT_BINARY_DIR}/gen_ops_def.yml")  
set(GENERATED_MODEL_HEADER "${CMAKE_CURRENT_BINARY_DIR}/model_pte.h")

# Build script location
set(BUILD_MODEL_SCRIPT "${CMAKE_CURRENT_SOURCE_DIR}/../scripts/build_model.py")

# Add custom command to generate header files from existing .pte model
add_custom_command(
    OUTPUT 
        ${GENERATED_OPS_DEF_FILE}
        ${GENERATED_MODEL_HEADER}
    COMMAND 
        ${Python3_EXECUTABLE} ${BUILD_MODEL_SCRIPT}
        --executorch-root "${EXECUTORCH_DIR}"
        --model-file "${CONFIG_EXECUTORCH_MODEL_NAME}"
        --sample-dir "${CMAKE_CURRENT_SOURCE_DIR}"
        --build-dir "${CMAKE_CURRENT_BINARY_DIR}"
    WORKING_DIRECTORY ${CMAKE_CURRENT_SOURCE_DIR}
    DEPENDS ${BUILD_MODEL_SCRIPT}
    COMMENT "Generating ExecuTorch headers from ${CONFIG_EXECUTORCH_MODEL_NAME}"
    VERBATIM
)

# Create a custom target that depends on the generated files
add_custom_target(generate_model_files ALL
    DEPENDS 
        ${GENERATED_OPS_DEF_FILE}
        ${GENERATED_MODEL_HEADER}
)

# Set EXECUTORCH_ROOT for the Codegen.cmake file 
set(EXECUTORCH_ROOT ${EXECUTORCH_DIR})

include(${EXECUTORCH_DIR}/tools/cmake/Utils.cmake)
include(${EXECUTORCH_DIR}/tools/cmake/Codegen.cmake)

# Generate selective operators library
gen_selected_ops(
    LIB_NAME "hello_world_ops_lib" 
    OPS_SCHEMA_YAML "${GENERATED_OPS_DEF_FILE}"
)

# Generate bindings for the selected kernels
generate_bindings_for_kernels(
    LIB_NAME "hello_world_ops_lib" 
    FUNCTIONS_YAML "${GENERATED_OPS_DEF_FILE}"
)

# Create the actual library target with portable kernels
gen_operators_lib(
    LIB_NAME "hello_world_ops_lib" 
    KERNEL_LIBS portable_kernels
    DEPS executorch_core
)

message(STATUS "Using ExecuTorch ${EXECUTORCH_BACKEND_TYPE} backend with libraries: ${EXECUTORCH_LIBS}")

set(app_sources
    src/main.cpp
    src/program_loader.cpp
    src/pal_zephyr.cpp
)
target_sources(app PRIVATE ${app_sources})

# Make sure the model generation happens before compiling the app
add_dependencies(app generate_model_files)

# Link with ExecuTorch and our operators library
target_link_libraries(app PRIVATE 
    libexecutorch
    hello_world_ops_lib
)

# Add include directories for generated headers and source files
target_include_directories(app PRIVATE 
    src
    ${CMAKE_CURRENT_BINARY_DIR}  # For generated model_pte.h
)

# Force include local warning suppressions header to prevent compilation warnings
target_compile_options(app PRIVATE 
    -include ${CMAKE_CURRENT_SOURCE_DIR}/warning_suppressions.h
) 
```

## sample.yaml
```
sample:
  description: Hello World ExecuTorch sample
  name: hello world executorch
common:
  tags: executorch
  modules:
    - executorch
  harness: console
  harness_config:
    type: multi_line
    ordered: false
    regex:
      - "Hello World from ExecuTorch"
tests:
  sample.executorch.helloworld:
    platform_allow:
      - qemu_x86
      - qemu_x86_64
    integration_platforms:
      - qemu_x86
    tags: executorch
    filter: CONFIG_FULL_LIBC_SUPPORTED 
```

## prj.conf
```kconfig
# Enable ExecuTorch
CONFIG_EXECUTORCH=y

# C++
CONFIG_CPP=y
CONFIG_STD_CPP17=y
CONFIG_NEWLIB_LIBC=y

# Config - increased for ExecuTorch memory requirements
CONFIG_MAIN_STACK_SIZE=8192
CONFIG_HEAP_MEM_POOL_SIZE=32768
CONFIG_REQUIRES_FLOAT_PRINTF=y

# Logging
CONFIG_LOG=y
CONFIG_LOG_PRINTK=y
CONFIG_CBPRINTF_FP_SUPPORT=y


# Disable default portable operators registry when using selective operators
# (portable kernels will be automatically built to support selective builds)
CONFIG_EXECUTORCH_BUILD_PORTABLE_OPS=n
```

## boards/native_sim.conf
```kconfig
# Board-specific configuration for Native Simulation
# ExecuTorch configuration

# Use portable backend for native simulation (no ARM backend)
# CONFIG_EXECUTORCH_BACKEND_ARM is intentionally not set

# Memory pool sizes for ExecuTorch execution  
# Native simulation has more memory available than embedded targets
# Method allocator pool: 32KB (generous for native)
CONFIG_EXECUTORCH_METHOD_ALLOCATOR_POOL_SIZE=32768
# Temporary allocator pool: 8KB (generous for native)
CONFIG_EXECUTORCH_TEMP_ALLOCATOR_POOL_SIZE=8192

# Model configuration
CONFIG_EXECUTORCH_MODEL_NAME="model_add.pte"

# Native simulation optimizations
# Larger stack sizes since memory is not as constrained
CONFIG_MAIN_STACK_SIZE=16384

# Enable console output for debugging
CONFIG_CONSOLE=y
CONFIG_SERIAL=y
CONFIG_UART_CONSOLE=y

# Additional logging for debugging
CONFIG_LOG=y
CONFIG_PRINTK=y

# Native-specific: Enable POSIX API for better compatibility
CONFIG_POSIX_API=y
CONFIG_EVENTFD=y 
```

## boards/native_sim_native_64.conf
```kconfig
# Board-specific configuration for Native Simulation (64-bit)
# ExecuTorch configuration

# Use portable backend for native simulation (no ARM backend)
# CONFIG_EXECUTORCH_BACKEND_ARM is intentionally not set

# Memory pool sizes for ExecuTorch execution  
# Native simulation has more memory available than embedded targets
# Method allocator pool: 64KB (very generous for native 64-bit)
CONFIG_EXECUTORCH_METHOD_ALLOCATOR_POOL_SIZE=65536
# Temporary allocator pool: 16KB (very generous for native 64-bit)
CONFIG_EXECUTORCH_TEMP_ALLOCATOR_POOL_SIZE=16384

# Model configuration
CONFIG_EXECUTORCH_MODEL_NAME="model_add.pte"

# Native simulation optimizations
# Larger stack sizes since memory is not as constrained
CONFIG_MAIN_STACK_SIZE=32768

# Enable console output for debugging
CONFIG_CONSOLE=y
CONFIG_SERIAL=y
CONFIG_UART_CONSOLE=y

# Additional logging for debugging
CONFIG_LOG=y
CONFIG_PRINTK=y

# Native-specific: Enable POSIX API for better compatibility
CONFIG_POSIX_API=y
CONFIG_EVENTFD=y

# Note: CONFIG_64BIT is automatically set by Zephyr for native_sim/native/64 
```

## boards/nrf54l15dk_nrf54l15_cpuapp.conf
```kconfig
# Board-specific configuration for nRF54L15DK
# ExecuTorch configuration

# Enable ARM backend for ExecuTorch
CONFIG_EXECUTORCH_BACKEND_ARM=y

# Memory pool sizes for ExecuTorch execution
# Method allocator pool: 16KB
CONFIG_EXECUTORCH_METHOD_ALLOCATOR_POOL_SIZE=16384
# Temporary allocator pool: 2KB
CONFIG_EXECUTORCH_TEMP_ALLOCATOR_POOL_SIZE=2048

# Model configuration
CONFIG_EXECUTORCH_MODEL_NAME="model_add.pte" 
```

## boards/qemu_cortex_m3.conf
```kconfig
# Board-specific configuration for QEMU Cortex-M3
# ExecuTorch configuration

# Enable ARM backend for ExecuTorch
CONFIG_EXECUTORCH_BACKEND_ARM=y

# Memory pool sizes for ExecuTorch execution
# Very reduced sizes for QEMU Cortex-M3 environment with extremely limited memory (64KB total)
# Method allocator pool: 4KB (minimal for simple models)
CONFIG_EXECUTORCH_METHOD_ALLOCATOR_POOL_SIZE=4096
# Temporary allocator pool: 512B (minimal)  
CONFIG_EXECUTORCH_TEMP_ALLOCATOR_POOL_SIZE=512

# Model configuration
CONFIG_EXECUTORCH_MODEL_NAME="model_add.pte"

# QEMU-specific optimizations for minimal memory usage
# Reduce main stack size to save memory
CONFIG_MAIN_STACK_SIZE=4096

# Reduce system workqueue stack size
CONFIG_SYSTEM_WORKQUEUE_STACK_SIZE=1024

# Disable optional features to save memory
CONFIG_PRINTK=y
CONFIG_EARLY_CONSOLE=y
CONFIG_CONSOLE=y
CONFIG_SERIAL=y
CONFIG_UART_CONSOLE=y

# Memory optimization
CONFIG_HEAP_MEM_POOL_SIZE=8192

# Reduce number of system resources
CONFIG_NUM_COOP_PRIORITIES=8
CONFIG_NUM_PREEMPT_PRIORITIES=8

# Disable features we don't need
CONFIG_THREAD_MONITOR=n
CONFIG_THREAD_NAME=n
CONFIG_STATS=n 
```

## src/main.cpp
```c
/*
 * Copyright (c) 2025 Petri Oksanen
 *
 * SPDX-License-Identifier: Apache-2.0
 */

#include <zephyr/kernel.h>
#include <zephyr/logging/log.h>

#include "program_loader.h"

LOG_MODULE_REGISTER(main, LOG_LEVEL_INF);

int main(void) {
	LOG_INF("ExecuTorch Hello World Sample");
	
	// Get program loader instance and initialize it
	ProgramLoader& loader = ProgramLoader::getInstance();
	loader.initialize();
	
	// Load the embedded model
	auto error = loader.loadProgram();
	if (error != executorch::runtime::Error::Ok) {
		LOG_ERR("Failed to load program: %d", (int)error);
		return -1;
	}
	
	LOG_INF("Program loaded successfully");
	
	// Test data: simple addition
	float input1[] = {2.0f};
	float input2[] = {3.0f};
	float output[1];
	
	// Run inference
	error = loader.runInference(input1, input2, 1, output, 1);
	if (error != executorch::runtime::Error::Ok) {
		LOG_ERR("Inference failed: %d", (int)error);
		return -1;
	}
	
	LOG_INF("Inference result: %.2f + %.2f = %.2f", 
			input1[0], input2[0], output[0]);
	
	// Expected result should be 5.0
	if (output[0] == 5.0f) {
		LOG_INF("✓ Test PASSED: Addition worked correctly!");
	} else {
		LOG_ERR("✗ Test FAILED: Expected 5.0, got %.2f", output[0]);
		return -1;
	}
	
	return 0;
} 
```

## src/et_memory_allocator.hpp
```c
#ifndef ET_MEMORY_ALLOCATOR_HPP
#define ET_MEMORY_ALLOCATOR_HPP

#include <executorch/runtime/core/memory_allocator.h>

using executorch::runtime::MemoryAllocator;

class ETMemoryAllocator : public MemoryAllocator {
public:
    ETMemoryAllocator(uint32_t size, uint8_t* base_address) : MemoryAllocator(size, base_address), used_(0) {}

    void* allocate(size_t size, size_t alignment = kDefaultAlignment) override {
        void* ret = MemoryAllocator::allocate(size, alignment);
        if (ret != nullptr) {
            if ((size & (alignment - 1)) == 0) {
                used_ += size;
            } else {
                used_ = (used_ & ~(alignment - 1)) + alignment + size;
            }
        }
        return ret;
    }

    size_t used_size() const { return used_; }
    size_t free_size() const { return MemoryAllocator::size() - used_; }

private:
    size_t used_;
};

#endif  // ET_MEMORY_ALLOCATOR_HPP
```

## src/pal_zephyr.cpp
```c
/*
 * Copyright (c) 2025 Petri Oksanen
 *
 * SPDX-License-Identifier: Apache-2.0
 */

#include <executorch/runtime/platform/platform.h>
#include <zephyr/kernel.h>
#include <zephyr/sys/printk.h>

void et_pal_init(void) {}

ET_NORETURN void et_pal_abort(void) {
	k_panic();
	// k_panic() should never return, but ensure compiler knows this
	while (1) {
		/* Never reached */
	}
}

et_timestamp_t et_pal_current_ticks(void) {
	return k_uptime_ticks();
}

et_tick_ratio_t et_pal_ticks_to_ns_multiplier(void) {
	return { NSEC_PER_SEC, sys_clock_hw_cycles_per_sec() };
}

void et_pal_emit_log_message(
    ET_UNUSED et_timestamp_t timestamp,
    ET_UNUSED et_pal_log_level_t level,
    ET_UNUSED const char* filename,
    ET_UNUSED const char* function,
    ET_UNUSED size_t line,
    const char* message,
    ET_UNUSED size_t length) {
	printk("%s\n", message);
}

void* et_pal_allocate(size_t size) {
  return k_malloc(size);
}

void et_pal_free(void* ptr) {
  k_free(ptr);
} 
```

## src/program_loader.cpp
```c
#include "program_loader.h"

#include <zephyr/kernel.h>
#include <zephyr/logging/log.h>

#include <cstddef>
#include <memory>
#include <cstring>
#include <executorch/runtime/core/result.h>
#include <executorch/runtime/platform/platform.h>
#include <executorch/runtime/platform/runtime.h>
#include <executorch/runtime/executor/program.h>

#include "model_pte.h"
#include "et_memory_allocator.hpp"

LOG_MODULE_REGISTER(program_loader, LOG_LEVEL_INF);

using namespace torch::executor;

// Memory pools for ExecuTorch execution
// Sizes are configurable via Kconfig
#ifndef CONFIG_EXECUTORCH_METHOD_ALLOCATOR_POOL_SIZE
#define CONFIG_EXECUTORCH_METHOD_ALLOCATOR_POOL_SIZE (16 * 1024)  // 16KB default
#endif
#ifndef CONFIG_EXECUTORCH_TEMP_ALLOCATOR_POOL_SIZE
#define CONFIG_EXECUTORCH_TEMP_ALLOCATOR_POOL_SIZE (2 * 1024)     // 2KB default
#endif

static unsigned char method_allocation_pool[CONFIG_EXECUTORCH_METHOD_ALLOCATOR_POOL_SIZE];
static unsigned char temp_allocation_pool[CONFIG_EXECUTORCH_TEMP_ALLOCATOR_POOL_SIZE];

ProgramLoader::ProgramLoader() 
    : initialized_(false),
      method_(nullptr) {
    // Constructor is now minimal - no complex initialization
}

void ProgramLoader::initialize() {
    if (initialized_) {
        return; // Already initialized
    }
    
    LOG_INF("Initializing ProgramLoader...");
    
    // Initialize ExecuTorch runtime
    executorch::runtime::runtime_init();
    
    // Create memory allocators
    method_allocator_ = std::make_unique<ETMemoryAllocator>(
        CONFIG_EXECUTORCH_METHOD_ALLOCATOR_POOL_SIZE, 
        method_allocation_pool
    );
    
    temp_allocator_ = std::make_unique<ETMemoryAllocator>(
        CONFIG_EXECUTORCH_TEMP_ALLOCATOR_POOL_SIZE, 
        temp_allocation_pool
    );
    
    initialized_ = true;
    LOG_INF("ProgramLoader initialized successfully");
}

Error ProgramLoader::loadProgram() {
    // Ensure we're initialized
    if (!initialized_) {
        LOG_ERR("ProgramLoader not initialized - call initialize() first");
        return Error::InvalidState;
    }
    
    // Calculate model size from the array
    size_t model_size = sizeof(model_pte);
    
    LOG_INF("Loading embedded program, size: %zu bytes", model_size);
    
    // Create data loader for embedded model
    auto loader = std::make_unique<BufferDataLoader>(model_pte, model_size);
    
    // Load program
    auto program_result = Program::load(loader.get());
    if (!program_result.ok()) {
        LOG_ERR("Failed to load program: %d", (int)program_result.error());
        return program_result.error();
    }
    
    program_ = std::make_unique<Program>(std::move(program_result.get()));
    LOG_INF("Program loaded successfully");
    
    // Get method metadata to determine memory planning requirements
    auto method_meta_result = program_->method_meta("forward");
    if (!method_meta_result.ok()) {
        LOG_ERR("Failed to get method metadata: %d", (int)method_meta_result.error());
        return method_meta_result.error();
    }
    
    MethodMeta method_meta = method_meta_result.get();
    
    // Allocate memory-planned buffers
    size_t num_memory_planned_buffers = method_meta.num_memory_planned_buffers();
    LOG_INF("Method requires %zu memory-planned buffers", num_memory_planned_buffers);
    
    planned_buffers_.clear();
    planned_spans_.clear();
    
    for (size_t id = 0; id < num_memory_planned_buffers; ++id) {
        auto buffer_size_result = method_meta.memory_planned_buffer_size(id);
        if (!buffer_size_result.ok()) {
            LOG_ERR("Failed to get buffer size for buffer %zu: %d", id, (int)buffer_size_result.error());
            return buffer_size_result.error();
        }
        
        size_t buffer_size = static_cast<size_t>(buffer_size_result.get());
        LOG_INF("Allocating planned buffer %zu, size %zu bytes", id, buffer_size);
        
        uint8_t* buffer = reinterpret_cast<uint8_t*>(method_allocator_->allocate(buffer_size));
        if (!buffer) {
            LOG_ERR("Failed to allocate memory-planned buffer %zu of size %zu", id, buffer_size);
            return Error::MemoryAllocationFailed;
        }
        
        planned_buffers_.push_back(buffer);
        planned_spans_.push_back({planned_buffers_.back(), buffer_size});
    }
    
    // Create hierarchical allocator for planned memory
    planned_memory_ = std::make_unique<HierarchicalAllocator>(
        HierarchicalAllocator({planned_spans_.data(), planned_spans_.size()})
    );
    
    // Update memory manager with planned memory
    memory_manager_ = std::make_unique<MemoryManager>(
        method_allocator_.get(),         // method_allocator
        planned_memory_.get(),           // planned_memory 
        temp_allocator_.get()           // temp_allocator
    );
    
    // Load method with updated memory manager
    auto method_result = program_->load_method("forward", memory_manager_.get());
    if (!method_result.ok()) {
        LOG_ERR("Failed to load method 'forward': %d", (int)method_result.error());
        return method_result.error();
    }
    
    method_ = std::make_unique<Result<Method>>(std::move(method_result));
    LOG_INF("Method 'forward' loaded successfully");
    
    return Error::Ok;
}

Error ProgramLoader::createInputTensor(const float* data, size_t size, size_t input_index) {
    if (!isLoaded()) {
        LOG_ERR("Program not loaded");
        return Error::InvalidState;
    }
    
    Method& method = method_->get();
    
    // Get input tensor metadata
    auto tensor_meta_result = method.method_meta().input_tensor_meta(input_index);
    if (!tensor_meta_result.ok()) {
        LOG_ERR("Failed to get input tensor meta for index %zu: %d", 
                input_index, (int)tensor_meta_result.error());
        return tensor_meta_result.error();
    }
    
    TensorInfo tensor_meta = tensor_meta_result.get();
    
    // Validate input size
    size_t expected_bytes = tensor_meta.nbytes();
    size_t provided_bytes = size * sizeof(float);
    
    if (provided_bytes != expected_bytes) {
        LOG_ERR("Input size mismatch for tensor %zu: expected %zu bytes, got %zu bytes",
                input_index, expected_bytes, provided_bytes);
        return Error::InvalidArgument;
    }
    
    // Create metadata arrays with persistent storage
    static std::vector<int32_t> sizes_storage[2];  // Support up to 2 input tensors
    static std::vector<uint8_t> dim_order_storage[2];
    static std::unique_ptr<TensorImpl> tensor_impls[2];  // Persistent storage for TensorImpl objects
    
    if (input_index >= 2) {
        LOG_ERR("Input index %zu exceeds supported maximum of 2", input_index);
        return Error::InvalidArgument;
    }
    
    // Copy metadata to persistent storage
    sizes_storage[input_index].assign(tensor_meta.sizes().begin(), tensor_meta.sizes().end());
    dim_order_storage[input_index].assign(tensor_meta.dim_order().begin(), tensor_meta.dim_order().end());
    
    // Create TensorImpl with persistent metadata using unique_ptr for proper lifecycle
    tensor_impls[input_index] = std::make_unique<TensorImpl>(
        ScalarType::Float,
        sizes_storage[input_index].size(),
        sizes_storage[input_index].data(),
        const_cast<void*>(static_cast<const void*>(data)),
        dim_order_storage[input_index].data()
    );
    
    // Create Tensor and EValue
    Tensor tensor(tensor_impls[input_index].get());
    EValue tensor_evalue(tensor);
    
    // Set input
    Error error = method.set_input(tensor_evalue, input_index);
    if (error != Error::Ok) {
        LOG_ERR("Failed to set input tensor %zu: %d", input_index, (int)error);
        return error;
    }
    
    LOG_DBG("Input tensor %zu set successfully", input_index);
    return Error::Ok;
}

Error ProgramLoader::runInference(const float* input1, const float* input2, size_t input_size,
                                 float* output, size_t output_size) {
    if (!isLoaded()) {
        LOG_ERR("Program not loaded");
        return Error::InvalidState;
    }
    
    Method& method = method_->get();
    
    LOG_INF("Running inference with inputs of size %zu", input_size);
    
    // Set input tensors
    Error error = createInputTensor(input1, input_size, 0);
    if (error != Error::Ok) {
        return error;
    }
    
    error = createInputTensor(input2, input_size, 1);
    if (error != Error::Ok) {
        return error;
    }
    
    // Execute the method
    error = method.execute();
    if (error != Error::Ok) {
        LOG_ERR("Method execution failed: %d", (int)error);
        return error;
    }
    
    LOG_INF("Method executed successfully");
    
    // Get output
    EValue output_evalue = method.get_output(0);
    if (!output_evalue.isTensor()) {
        LOG_ERR("Output is not a tensor");
        return Error::InvalidArgument;
    }
    
    Tensor output_tensor = output_evalue.toTensor();
    
    // Validate output size
    size_t expected_elements = output_tensor.numel();
    if (output_size < expected_elements) {
        LOG_ERR("Output buffer too small: need %zu elements, got %zu",
                expected_elements, output_size);
        return Error::InvalidArgument;
    }
    
    // Copy output data
    const float* output_data = output_tensor.const_data_ptr<float>();
    std::memcpy(output, output_data, expected_elements * sizeof(float));
    
    LOG_INF("Inference completed, output size: %zu elements", expected_elements);
    return Error::Ok;
} 
```

## src/program_loader.h
```c
#ifndef PROGRAM_LOADER_H
#define PROGRAM_LOADER_H

#include <executorch/extension/data_loader/buffer_data_loader.h>
#include <executorch/runtime/core/memory_allocator.h>
#include <executorch/runtime/executor/program.h>
#include <executorch/runtime/platform/platform.h>
#include <executorch/runtime/platform/runtime.h>

#include <memory>
#include <vector>

#include "et_memory_allocator.hpp"

using executorch::aten::ScalarType;
using executorch::aten::Tensor;
using executorch::aten::TensorImpl;
using executorch::extension::BufferDataLoader;
using executorch::runtime::Error;
using executorch::runtime::EValue;
using executorch::runtime::HierarchicalAllocator;
using executorch::runtime::MemoryAllocator;
using executorch::runtime::MemoryManager;
using executorch::runtime::Method;
using executorch::runtime::MethodMeta;
using executorch::runtime::Program;
using executorch::runtime::Result;
using executorch::runtime::Span;
using executorch::runtime::Tag;
using executorch::runtime::TensorInfo;

/**
 * Simple program loader for ExecuTorch ARM Hello World sample
 * Loads embedded model and provides simple inference interface
 */
class ProgramLoader {
public:
    /**
     * Get singleton instance
     */
    static ProgramLoader& getInstance() {
        static ProgramLoader instance;
        return instance;
    }
    
    /**
     * Initialize the program loader (call once before first use)
     */
    void initialize();

    /**
     * Load the embedded program from model_pte.h
     * @return Error::Ok on success
     */
    Error loadProgram();

    /**
     * Run inference on the loaded model
     * @param input1 First input tensor data
     * @param input2 Second input tensor data  
     * @param input_size Size of input tensors
     * @param output Output tensor data
     * @param output_size Size of output tensor
     * @return Error::Ok on success
     */
    Error runInference(const float* input1, const float* input2, size_t input_size,
                      float* output, size_t output_size);

    /**
     * Check if program is loaded
     */
    bool isLoaded() const { return method_ != nullptr && method_->ok(); }

private:
    ProgramLoader();
    ~ProgramLoader() = default;
    
    // Disable copy/move
    ProgramLoader(const ProgramLoader&) = delete;
    ProgramLoader& operator=(const ProgramLoader&) = delete;
    ProgramLoader(ProgramLoader&&) = delete;
    ProgramLoader& operator=(ProgramLoader&&) = delete;

    /**
     * Create input tensor
     */
    Error createInputTensor(const float* data, size_t size, size_t input_index);

    // Initialization state
    bool initialized_;
    
    // Memory allocators
    std::unique_ptr<ETMemoryAllocator> method_allocator_;
    std::unique_ptr<ETMemoryAllocator> temp_allocator_;
    std::unique_ptr<MemoryManager> memory_manager_;
    std::unique_ptr<HierarchicalAllocator> planned_memory_;
    
    // ExecuTorch objects
    std::unique_ptr<Program> program_;
    std::unique_ptr<Result<Method>> method_;
    
    // Memory management
    std::vector<uint8_t*> planned_buffers_;
    std::vector<Span<uint8_t>> planned_spans_;
};

#endif // PROGRAM_LOADER_H
```
